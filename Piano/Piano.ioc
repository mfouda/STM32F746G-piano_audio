# file: Piano.ioc
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VP_TIM5_VS_ClockSourceINT.Mode=Internal
FREERTOS.Queues01=TS_pos,2,uint16_t,0,Dynamic,NULL,NULL
SH.FMC_A0.0=FMC_A0,12b-sda1
PH15.GPIO_Label=TP3
NVIC.TIM6_DAC_IRQn=true\:0\:0\:false\:false\:true\:false\:false\:true
PG8.Signal=FMC_SDCLK
PG0.Signal=FMC_A10
PI15.GPIO_Label=LCD_R0 [RK043FN48H-CT672B_R0]
PK1.Signal=LTDC_G6
SH.FMC_D5_DA5.0=FMC_D5,sd-16b-d1
SH.FMC_D9_DA9.0=FMC_D9,sd-16b-d1
PF7.Signal=UART7_TX
RCC.PLL48CLockSelection=RCC_CLK48SOURCE_PLLSAIP
SH.FMC_SDNWE.0=FMC_SDNWE,12b-sda1
PH9.Signal=GPIO_Output
SH.FMC_D11_DA11.0=FMC_D11,sd-16b-d1
PJ5.Mode=RGB888
RCC.APB2TimFreq_Value=200000000
PC7.Signal=USART6_RX
PD0.Signal=FMC_D2_DA2
PD8.Signal=FMC_D13_DA13
USART6.VirtualMode-Asynchronous=VM_ASYNC
PE1.Signal=FMC_NBL1
PK4.GPIO_Label=LCD_B5 [RK043FN48H-CT672B_B5]
PB12.GPIO_Label=ULPI_D5 [USB3320C-EZK_D5]
PJ14.Mode=RGB888
LTDC.PixelFormat_L0=LTDC_PIXEL_FORMAT_RGB565
PE9.Signal=FMC_D6_DA6
SH.FMC_A2.0=FMC_A2,12b-sda1
PB14.Mode=Full_Duplex_Master
PB1.GPIO_Label=ULPI_D2 [USB3320C-EZK_D2]
PE4.GPIO_Label=LCD_B0 [RK043FN48H-CT672B_B0]
PA8.Signal=GPIO_Input
SH.FMC_D1_DA1.0=FMC_D1,sd-16b-d1
VP_FREERTOS_VS_CMSIS_V1.Mode=CMSIS_V1
LTDC.HSync=41
PJ14.Signal=LTDC_B2
PB9.Signal=I2C1_SDA
Mcu.Package=TFBGA216
SAI2.RealAudioFreq-SAI_A_MasterWithClock=187.5 KHz
PB1.Signal=USB_OTG_HS_ULPI_D2
NVIC.TimeBase=TIM6_DAC_IRQn
SPI2.Mode=SPI_MODE_MASTER
NVIC.TimeBaseIP=TIM6
PB9.GPIO_PuPd=GPIO_NOPULL
VP_RTC_VS_RTC_Calendar.Mode=RTC_Calendar
RCC.APB2CLKDivider=RCC_HCLK_DIV2
PI7.Mode=SAI_A_MasterWithClock
LTDC.VSync=10
RCC.APB1TimFreq_Value=100000000
PC14/OSC32_IN.GPIO_Label=RCC_OSC32_IN
PF10.Mode=IN8
PB13.Mode=Host_HS
PJ13.Mode=RGB888
PH8.Mode=I2C
PD15.Signal=FMC_D1_DA1
PJ1.GPIO_Label=LCD_R2 [RK043FN48H-CT672B_R2]
PG12.Signal=LTDC_B4
PA5.Mode=Host_HS
PK4.Signal=LTDC_B5
SH.FMC_A4.0=FMC_A4,12b-sda1
FREERTOS.Tasks01=defaultTask,-3,128,StartDefaultTask,Default,NULL,Dynamic,NULL,NULL;Audio,1,1024,Audio_demo,Default,NULL,Dynamic,NULL,NULL;TS_scan,0,128,TS_scan_task,Default,NULL,Dynamic,NULL,NULL
ADC3.Channel-IN5=ADC_CHANNEL_5
ADC3.Channel-IN4=ADC_CHANNEL_4
PI13.GPIO_ModeDefaultEXTI=GPIO_MODE_EVT_RISING
PG5.Signal=FMC_A15_BA1
PC13.Signal=GPIO_Input
SH.FMC_D10_DA10.0=FMC_D10,sd-16b-d1
FREERTOS.INCLUDE_vTaskDelayUntil=1
PD3.Signal=GPIO_Output
PI10.Mode=RGB888
PC2.Signal=USB_OTG_HS_ULPI_DIR
PI12.Signal=GPIO_Output
PJ11.Signal=LTDC_G4
RCC.PLLSAIRDiv=RCC_PLLSAIDIVR_8
LTDC.ImageWidth_L0=480
PD10.Signal=FMC_D15_DA15
PJ6.Mode=RGB888
PA3.Mode=Host_HS
PB8.GPIO_Label=ARDUINO SCL/D15
PJ8.GPIO_Label=LCD_G1 [RK043FN48H-CT672B_G1]
PJ3.Signal=LTDC_R4
PI8.GPIO_Label=NC1 [TP2]
PA8.GPIO_Label=BP1
PH11.GPIO_Label=LED12
PI6.Mode=SAI_A_MasterWithClock
VP_TIM8_VS_ClockSourceINT.Mode=Internal
PJ11.GPIO_Label=LCD_G4 [RK043FN48H-CT672B_G4]
PB14.Signal=SPI2_MISO
PA5.Signal=USB_OTG_HS_ULPI_CK
PJ4.GPIO_Label=LCD_R5 [RK043FN48H-CT672B_R5]
PK7.GPIO_Label=LCD_DE [RK043FN48H-CT672B_DE]
PI7.Signal=SAI2_FS_A
SH.FMC_A6.0=FMC_A6,12b-sda1
PE14.Signal=FMC_D11_DA11
PG7.GPIO_Label=BP_JOYSTICK
PI2.Signal=S_TIM8_CH4
PF13.Signal=FMC_A7
PJ15.GPIO_Label=LCD_B3 [RK043FN48H-CT672B_B3]
NVIC.DMA2_Stream4_IRQn=true\:5\:0\:false\:false\:true\:true\:false\:true
PJ15.Mode=RGB888
ADC1.master=1
SAI2.Instance-SAI_A_MasterWithClock=SAI$Index_Block_A
PA5.GPIO_Label=ULPI_CLK [USB3320C-EZK_CLKOUT]
PK4.Mode=RGB888
PE5.GPIO_Label=LED14
PJ8.Signal=LTDC_G1
PJ0.GPIO_Label=LCD_R1 [RK043FN48H-CT672B_R1]
ProjectManager.HeapSize=0x200
PB1.Mode=Host_HS
PH6.Signal=GPIO_Output
FREERTOS.configUSE_RECURSIVE_MUTEXES=1
NVIC.PriorityGroup=NVIC_PRIORITYGROUP_4
PI1.GPIO_Mode=GPIO_MODE_AF_PP
PE3.Signal=GPIO_Input
PJ4.Mode=RGB888
PC15/OSC32_OUT.Signal=RCC_OSC32_OUT
PF4.Signal=FMC_A4
PI1.GPIO_Label=ARDUINO SCK/D13
Mcu.Family=STM32F7
LTDC.BlendingFactor1_L0=LTDC_BLENDING_FACTOR1_PAxCA
PK3.Signal=GPIO_Output
SPI2.VirtualNSS=VM_NSSHARD
SH.FMC_A8.0=FMC_A8,12b-sda1
PC15/OSC32_OUT.GPIO_Label=RCC_OSC32_OUT
PH14.Signal=GPIO_Output
PH10.Signal=GPIO_Output
SH.FMC_D14_DA14.0=FMC_D14,sd-16b-d1
PG2.Signal=GPIO_Input
PC14/OSC32_IN.Mode=LSE-External-Oscillator
SH.FMC_A14_BA0.0=FMC_BA0,FourSdramBanks1
SH.FMC_A11.0=FMC_A11,12b-sda1
PB13.GPIO_Label=ULPI_D6 [USB3320C-EZK_D6]
PI5.Mode=SAI_A_MasterWithClock
PB15.Signal=SPI2_MOSI
ADC3.Channel-0\#ChannelRegularConversion=ADC_CHANNEL_6
VP_RTC_VS_RTC_Alarm_B_Intern.Mode=Alarm B
PJ5.GPIO_Label=LCD_R6 [RK043FN48H-CT672B_R6]
PG15.Signal=FMC_SDNCAS
PJ14.GPIO_Label=LCD_B2 [RK043FN48H-CT672B_B2]
PJ2.Signal=LTDC_R3
SH.FMC_NBL1.0=FMC_NBL1,Sd2ByteEnable1
LTDC.WindowX1_L0=480
PI9.Mode=RGB888
PK2.Mode=RGB888
TIM3.Channel-PWM\ Generation1\ CH1=TIM_CHANNEL_1
PA9.GPIO_Mode=GPIO_MODE_AF_PP
ADC1.Channel-0\#ChannelRegularConversion=ADC_CHANNEL_0
RCC.HSE_VALUE=25000000
PI14.Mode=RGB888
PF9.Mode=IN7
PA14.Mode=Serial_Wire
PH7.GPIO_Label=LCD_SCL [RK043FN48H-CT672B_SCL]
PJ7.GPIO_Label=LCD_G0 [RK043FN48H-CT672B_G0]
PF11.Signal=FMC_SDNRAS
PB5.Mode=Host_HS
PJ12.GPIO_Label=OTG_FS_VBUS
PB7.Signal=USART1_RX
SH.S_TIM3_CH1.0=TIM3_CH1,PWM Generation1 CH1
PI8.Mode=Timestamp enabled - Input Enabled to TS
PB7.GPIO_Label=VCP_RX [STM32F103CBT6_PA2]
PB12.Mode=Host_HS
PD5.GPIO_Label=OTG_FS_PowerSwitchOn [STMPS2141STR_EN]
PF8.Signal=ADC3_IN6
PI1.Mode=Full_Duplex_Master
I2C3.Timing=0x00C0EAFF
PB5.GPIO_Label=ULPI_D7 [USB3320C-EZK_D7]
PD3.GPIO_Label=LED16
PE7.Signal=FMC_D4_DA4
PD6.Signal=GPXTI6
Dma.Request0=SAI2_A
PI15.Mode=RGB888
VP_TIM3_VS_ClockSourceINT.Mode=Internal
PB4.Signal=S_TIM3_CH1
PG2.GPIO_Label=RMII_RXER
PA3.Signal=USB_OTG_HS_ULPI_D0
SAI2.MClockEnable-SAI_A_MasterWithClock=SAI_MASTERCLOCK_ENABLE
PK1.Mode=RGB888
PK6.Signal=LTDC_B7
NVIC.LTDC_IRQn=true\:5\:0\:false\:false\:true\:true\:true\:true
LTDC.WindowY1_L0=272
PG7.Signal=GPIO_Input
PJ8.Mode=RGB888
PH12.GPIO_Label=LED17
PI14.Signal=LTDC_CLK
PC2.Mode=Host_HS
PD9.Signal=FMC_D14_DA14
PA9.GPIO_PuPd=GPIO_NOPULL
USART1.VirtualMode-Asynchronous=VM_ASYNC
PA13.Signal=SYS_JTMS-SWDIO
FREERTOS.configUSE_IDLE_HOOK=1
PA9.Mode=Asynchronous
PF6.Signal=UART7_RX
SH.FMC_D13_DA13.0=FMC_D13,sd-16b-d1
PH8.Signal=I2C3_SDA
PB9.Mode=I2C
RCC.USBFreq_Value=48000000
PK5.Mode=RGB888
board=STM32F746G-DISCO
PG12.Mode=RGB888
RCC.VCOOutputFreq_Value=400000000
PI9.Signal=LTDC_VSYNC
PH4.GPIO_Label=ULPI_NXT [USB3320C-EZK_NXT]
PB15.Mode=Full_Duplex_Master
PI13.GPIO_Label=LCD_INT
PI4.Signal=SAI2_MCLK_A
SH.FMC_D12_DA12.0=FMC_D12,sd-16b-d1
PI1.GPIO_Speed=GPIO_SPEED_FREQ_LOW
PF1.Signal=FMC_A1
PJ0.Signal=LTDC_R1
PE0.Signal=FMC_NBL0
RTC.Alarm-Alarm\ A=RTC_ALARM_A
PE12.Signal=FMC_D9_DA9
RCC.SYSCLKFreq_VALUE=200000000
PJ5.Signal=LTDC_R6
RCC.HSI_VALUE=16000000
PH0/OSC_IN.GPIO_Label=OSC_25M [NZ2520SB-25.00M_OUT]
RCC.PLLQ=9
PI3.GPIO_Label=LED3
PH3.Signal=FMC_SDNE0
RCC.PLLM=25
RCC.PLLN=400
PA9.GPIO_Speed=GPIO_SPEED_FREQ_LOW
PB8.GPIO_Speed=GPIO_SPEED_FREQ_LOW
PJ2.GPIO_Label=LCD_R3 [RK043FN48H-CT672B_R3]
LTDC.ImageHeight_L0=272
RCC.PLLI2SN=100
Dma.SAI2_A.0.Priority=DMA_PRIORITY_LOW
PB12.Signal=USB_OTG_HS_ULPI_D5
PK1.GPIO_Label=LCD_G6 [RK043FN48H-CT672B_G6]
PJ13.Signal=LTDC_B1
PA3.GPIO_Label=ULPI_D0 [USB3320C-EZK_D0]
PI12.PinState=GPIO_PIN_SET
SH.FMC_D7_DA7.0=FMC_D7,sd-16b-d1
RTC.Alarm_B-Alarm\ B=RTC_ALARM_B
PK5.Signal=LTDC_B6
VP_SYS_VS_tim6.Mode=TIM6
PJ9.Mode=RGB888
PH12.Signal=GPIO_Output
SPI2.VirtualType=VM_MASTER
PK0.Mode=RGB888
PG4.Signal=FMC_A14_BA0
PA14.GPIO_Label=SWCLK
PH6.GPIO_Label=LED2
PK6.GPIO_Label=LCD_B7 [RK043FN48H-CT672B_B7]
VP_RTC_VS_RTC_Activate.Mode=RTC_Enabled
PJ6.GPIO_Label=LCD_R7 [RK043FN48H-CT672B_R7]
TIM8.Channel-PWM\ Generation4\ CH4=TIM_CHANNEL_4
PB13.Signal=USB_OTG_HS_ULPI_D6
PD6.GPIO_Label=Audio_INT
PE6.GPIO_Label=LED15
RCC.SYSCLKSource=RCC_SYSCLKSOURCE_PLLCLK
PJ10.Signal=LTDC_G3
SH.FMC_A15_BA1.0=FMC_BA1,FourSdramBanks1
PB7.GPIO_Mode=GPIO_MODE_AF_PP
PJ13.GPIO_Label=LCD_B1 [RK043FN48H-CT672B_B1]
PH5.Signal=FMC_SDNWE
PD4.Signal=GPIO_Input
PH1/OSC_OUT.Signal=RCC_OSC_OUT
PC3.Signal=FMC_SDCKE0
PE5.Signal=GPIO_Output
PH10.GPIO_Label=LED18
Dma.SAI2_A.0.PeriphInc=DMA_PINC_DISABLE
PK7.Mode=RGB888
PJ2.Mode=RGB888
SAI2.DataSize-SAI_A_MasterWithClock=SAI_DATASIZE_8
PI6.Signal=SAI2_SD_A
PI3.Signal=GPIO_Output
SPI2.CalculateBaudRate=25.0 MBits/s
PF8.Mode=IN6
PF3.Signal=FMC_A3
PE10.Signal=FMC_D7_DA7
VP_TIM1_VS_ClockSourceINT.Mode=Internal
ADC1.SamplingTime-0\#ChannelRegularConversion=ADC_SAMPLETIME_3CYCLES
SAI2.ErrorAudioFreq-SAI_A_MasterWithClock=-2.34 %
RCC.SDMMCClockSelection=RCC_SDMMC1CLKSOURCE_CLK48
SH.S_TIM8_CH4.0=TIM8_CH4,PWM Generation4 CH4
PD6.GPIO_ModeDefaultEXTI=GPIO_MODE_EVT_RISING
Dma.SAI2_A.0.MemInc=DMA_MINC_ENABLE
Dma.SAI2_A.0.PeriphDataAlignment=DMA_PDATAALIGN_HALFWORD
PJ4.Signal=LTDC_R5
SH.FMC_A1.0=FMC_A1,12b-sda1
PH2.Signal=GPIO_Input
SH.FMC_SDCLK.0=FMC_SDCLK,12b-sda1
PF14.Signal=FMC_A8
VP_DMA2D_VS_DMA2D.Mode=DMA2D_Activate
PJ1.Mode=RGB888
SH.FMC_D3_DA3.0=FMC_D3,sd-16b-d1
PI10.GPIO_Label=LCD_HSYNC [RK043FN48H-CT672B_HSYNC]
PB7.GPIO_PuPd=GPIO_NOPULL
PK3.PinState=GPIO_PIN_SET
PH15.Signal=GPIO_Input
ADC1.Rank-0\#ChannelRegularConversion=1
PI4.Mode=SAI_A_MasterWithClock
PA9.GPIO_Label=VCP_TX [STM32F103CBT6_PA3]
FREERTOS.configCHECK_FOR_STACK_OVERFLOW=2
PB8.GPIO_PuPd=GPIO_NOPULL
PC6.Signal=USART6_TX
PB11.GPIO_Label=ULPI_D4 [USB3320C-EZK_D4]
PD1.Signal=FMC_D3_DA3
PC0.Signal=USB_OTG_HS_ULPI_STP
RCC.APB1CLKDivider=RCC_HCLK_DIV4
SH.FMC_A3.0=FMC_A3,12b-sda1
PJ7.Signal=LTDC_G0
PB11.Mode=Host_HS
SH.FMC_D15_DA15.0=FMC_D15,sd-16b-d1
PC6.Mode=Asynchronous
PA9.Signal=USART1_TX
I2C1.Timing=0x00C0EAFF
Dma.SAI2_A.0.Instance=DMA2_Stream4
Dma.SAI2_A.0.FIFOMode=DMA_FIFOMODE_DISABLE
PJ15.Signal=LTDC_B3
PH9.GPIO_Label=LED11
PI9.GPIO_Label=LCD_VSYNC [RK043FN48H-CT672B_VSYNC]
PE15.Signal=FMC_D12_DA12
PE8.Signal=FMC_D5_DA5
PI1.Signal=SPI2_SCK
SH.FMC_SDNCAS.0=FMC_SDNCAS,12b-sda1
PA13.Mode=Serial_Wire
Dma.SAI2_A.0.MemDataAlignment=DMA_MDATAALIGN_HALFWORD
PH4.Mode=Host_HS
PH14.GPIO_Label=LED13
PB5.Signal=USB_OTG_HS_ULPI_D7
FREERTOS.configUSE_COUNTING_SEMAPHORES=1
SH.FMC_A5.0=FMC_A5,12b-sda1
LTDC.Alpha_L0=255
PK3.GPIO_Label=LCD_BL_CTRL [STLD40DPUR_EN]
PF6.Mode=Asynchronous
PF9.Signal=ADC3_IN7
PJ10.Mode=RGB888
PB8.Mode=I2C
PG3.GPIO_Label=EXT_RST
PB0.Signal=USB_OTG_HS_ULPI_D1
PH2.GPIO_Label=NC2
PC3.Mode=SdramChipSelect1_1
Dma.SAI2_A.0.Mode=DMA_NORMAL
PK7.Signal=LTDC_DE
RCC.CortexFreq_Value=200000000
LTDC.HBP=13
SH.FMC_NBL0.0=FMC_NBL0,Sd2ByteEnable1
PC0.GPIO_Label=ULPI_STP [USB3320C-EZK_STP]
SH.FMC_D6_DA6.0=FMC_D6,sd-16b-d1
PA0/WKUP.Signal=ADCx_IN0
PB0.GPIO_Label=ULPI_D1 [USB3320C-EZK_D1]
PC13.GPIO_Label=uSD_Detect
PK5.GPIO_Label=LCD_B6 [RK043FN48H-CT672B_B6]
PB11.Signal=USB_OTG_HS_ULPI_D4
PI14.GPIO_Label=LCD_CLK [RK043FN48H-CT672B_CLK]
VP_RTC_VS_RTC_Alarm_A_Intern.Mode=Alarm A
ProjectManager.StackSize=0x400
PH3.Mode=SdramChipSelect1_1
PJ6.Signal=LTDC_R7
SH.FMC_A7.0=FMC_A7,12b-sda1
PH0/OSC_IN.Mode=HSE-External-Oscillator
RCC.HCLKFreq_Value=200000000
PF12.Signal=FMC_A6
FREERTOS.configUSE_MALLOC_FAILED_HOOK=1
PI13.Signal=GPXTI13
SH.FMC_A10.0=FMC_A10,12b-sda1
RCC.AHBFreq_Value=200000000
SH.FMC_D8_DA8.0=FMC_D8,sd-16b-d1
PI8.Signal=RTC_TS
SH.FMC_D2_DA2.0=FMC_D2,sd-16b-d1
PE13.Signal=FMC_D10_DA10
PI1.GPIO_PuPd=GPIO_NOPULL
PI5.Signal=SAI2_SCK_A
PK6.Mode=RGB888
PI0.Signal=SPI2_NSS
LTDC.HFP=32
SAI2.VirtualMode-SAI_A_MasterWithClock=VM_MASTER
LTDC.BlendingFactor2_L0=LTDC_BLENDING_FACTOR2_PAxCA
SH.ADCx_IN0.0=ADC1_IN0,IN0
PE4.Mode=RGB888
VP_TIM3_VS_ClockSourceITR.Mode=TriggerSource_ITR0
SH.FMC_SDNRAS.0=FMC_SDNRAS,12b-sda1
LTDC.ActiveW=480
PE4.Signal=LTDC_B0
PH1/OSC_OUT.Mode=HSE-External-Oscillator
FREERTOS.configTOTAL_HEAP_SIZE=32768
PH7.Mode=I2C
PJ0.Mode=RGB888
PJ9.Signal=LTDC_G2
SH.FMC_D0_DA0.0=FMC_D0,sd-16b-d1
PJ12.Signal=GPIO_Input
PC14/OSC32_IN.Signal=RCC_OSC32_IN
PK0.GPIO_Label=LCD_G5 [RK043FN48H-CT672B_G5]
SH.FMC_A9.0=FMC_A9,12b-sda1
PJ1.Signal=LTDC_R2
SH.FMC_D4_DA4.0=FMC_D4,sd-16b-d1
PI12.GPIO_Label=LCD_DISP [RK043FN48H-CT672B_DISP] 
RCC.PLLSAIN=384
PF5.Signal=FMC_A5
RCC.PLLSAIP=RCC_PLLSAIP_DIV8
RCC.PLLSAIR=5
PH7.Signal=I2C3_SCL
PB9.GPIO_Speed=GPIO_SPEED_FREQ_LOW
PJ3.GPIO_Label=LCD_R4 [RK043FN48H-CT672B_R4]
PK2.GPIO_Label=LCD_G7 [RK043FN48H-CT672B_G7]
PJ7.Mode=RGB888
SPI2.Direction=SPI_DIRECTION_2LINES
PF0.Signal=FMC_A0
PC2.GPIO_Label=ULPI_DIR [USB3320C-EZK_DIR]
PB7.GPIO_Speed=GPIO_SPEED_FREQ_LOW
RCC.PLLSourceVirtual=RCC_PLLSOURCE_HSE
PK2.Signal=LTDC_G7
LTDC.FBStartAdress_L0=0xC0000000
PB9.GPIO_Label=ARDUINO SDA/D14
PH11.Signal=GPIO_Output
PG3.Signal=GPIO_Output
PG1.Signal=FMC_A11
PI10.Signal=LTDC_HSYNC
PD5.Signal=GPIO_Output
FREERTOS.configUSE_APPLICATION_TASK_TAG=1
PC0.Mode=Host_HS
PJ11.Mode=RGB888
PF7.Mode=Asynchronous
PH8.GPIO_Label=LCD_SDA [RK043FN48H-CT672B_SDA]
PH4.Signal=USB_OTG_HS_ULPI_NXT
ProjectManager.TargetToolchain=STM32CubeIDE
LTDC.ActiveH=272
PI0.Mode=NSS_Signal_Hard_Output
PJ9.GPIO_Label=LCD_G2 [RK043FN48H-CT672B_G2]
PF2.Signal=FMC_A2
PE11.Signal=FMC_D8_DA8
PK0.Signal=LTDC_G5
Dma.SAI2_A.0.Direction=DMA_MEMORY_TO_PERIPH
PJ10.GPIO_Label=LCD_G3 [RK043FN48H-CT672B_G3]
PB0.Mode=Host_HS
PB9.GPIO_Mode=GPIO_MODE_AF_OD
PJ3.Mode=RGB888
PH0/OSC_IN.Signal=RCC_OSC_IN
RCC.APB2Freq_Value=100000000
LTDC.Layers=0
VP_TIM2_VS_ClockSourceINT.Mode=Internal
PD4.GPIO_Label=OTG_FS_OverCurrent [STMPS2141STR_Fault]
PF10.Signal=ADC3_IN8
PF15.Signal=FMC_A9
PD5.PinState=GPIO_PIN_SET
PE6.Signal=GPIO_Output
Mcu.Name=STM32F746NGHx
PA13.GPIO_Label=SWDIO
PD14.Signal=FMC_D0_DA0
PC15/OSC32_OUT.Mode=LSE-External-Oscillator
PB7.Mode=Asynchronous
PA14.Signal=SYS_JTCK-SWCLK
PG12.GPIO_Label=LCD_B4 [RK043FN48H-CT672B_B4]
ADC1.NbrOfConversionFlag=1
PK3.GPIO_Speed=GPIO_SPEED_FREQ_LOW
PI15.Signal=LTDC_R0
PB8.Signal=I2C1_SCL
PC7.Mode=Asynchronous
PB8.GPIO_Mode=GPIO_MODE_AF_OD
RCC.APB1Freq_Value=50000000

// file: Core/Src/main.c
/* USER CODE BEGIN Header */
/**
  ******************************************************************************
  * @file           : main.c
  * @brief          : Audio Touch screen piano application
  * @autor			: Saša Radosavljevic
  ******************************************************************************
  * @attention
  *
  * <h2><center>&copy; Copyright (c) 2021 STMicroelectronics.
  * All rights reserved.</center></h2>
  *
  * This software component is licensed by ST under Ultimate Liberty license
  * SLA0044, the "License"; You may not use this file except in compliance with
  * the License. You may obtain a copy of the License at:
  *                             www.st.com/SLA0044
  *
  ******************************************************************************
  */
/* USER CODE END Header */
#include "main.h"
#include "cmsis_os.h"

/* USER CODE BEGIN Includes */
#include "stm32746g_discovery_lcd.h"
#include "stm32746g_discovery_ts.h"
#include "stm32746g_discovery_audio.h"
#include "stm32f7xx_hal_sai.h"
#include "stm32f7xx_it.h"
#include "stdio.h"
#include <string.h>
/* USER CODE END Includes */

/* USER CODE BEGIN PD */

// Global information
#define lcd_w 480
#define lcd_h 272

// Keys information
#define white_w 60
#define black_w 24
#define white_h 272
#define black_h 154

#define N_white 8
#define N_black 5

/*Since SysTick is set to 1ms (unless to set it quicker) */
/* to run up to 48khz, a buffer around 1000 (or more) is requested*/
/* to run up to 96khz, a buffer around 2000 (or more) is requested*/
#define AUDIO_BUFFER_SIZE       2048
#define AUDIO_DEFAULT_VOLUME    70

/* Audio file size and start address are defined here since the audio file is
   stored in Flash memory as a constant table of 16-bit data */
#define AUDIO_FILE_SIZE               524288
#define AUDIO_START_OFFSET_ADDRESS    0            /* Offset relative to audio file header size */
#define AUDIO_FILE_ADDRESS            0x08080000   /* Audio file address */

/* USER CODE END PD */

ADC_HandleTypeDef hadc1;
ADC_HandleTypeDef hadc3;

DMA2D_HandleTypeDef hdma2d;

I2C_HandleTypeDef hi2c1;
I2C_HandleTypeDef hi2c3;

LTDC_HandleTypeDef hltdc;

RTC_HandleTypeDef hrtc;

SAI_HandleTypeDef hsai_BlockA2;
DMA_HandleTypeDef hdma_sai2_a;

SPI_HandleTypeDef hspi2;

TIM_HandleTypeDef htim1;
TIM_HandleTypeDef htim2;
TIM_HandleTypeDef htim3;
TIM_HandleTypeDef htim5;
TIM_HandleTypeDef htim8;

UART_HandleTypeDef huart7;
UART_HandleTypeDef huart1;
UART_HandleTypeDef huart6;

SDRAM_HandleTypeDef hsdram1;

osThreadId defaultTaskHandle;
osThreadId AudioHandle;
osThreadId TS_scanHandle;
osMessageQId TS_posHandle;
/* USER CODE BEGIN PV */

// Keys positions
const uint16_t white[] = {0, white_w, white_w*2, white_w*3, white_w*4, white_w*5, white_w*6, white_w*7};
const uint16_t black[] = {white[1]-black_w/2, white[2]-black_w/2, white[4]-black_w/2, white[5]-black_w/2, white[6]-black_w/2};
const uint16_t white_up[] = {0, black[0]+black_w, black[1]+black_w, white_w*3, black[2]+black_w, black[3]+black_w, black[4]+black_w, white_w*7};
const uint16_t white_up_w[] = {white_w - black_w/2, white_w - black_w, white_w - black_w/2, white_w - black_w/2, white_w - black_w, white_w - black_w, white_w - black_w/2, white_w};

// Simultaneous touches
uint8_t nb_appuis = 0;

// Audio
typedef enum {
  AUDIO_ERROR_NONE = 0,
  AUDIO_ERROR_NOTREADY,
  AUDIO_ERROR_IO,
  AUDIO_ERROR_EOF,
}AUDIO_ErrorTypeDef;

typedef enum {
	AUDIO_STATE_IDLE = 0,
	AUDIO_STATE_INIT,
	AUDIO_STATE_PLAYING,
}AUDIO_PLAYBACK_StateTypeDef;

typedef enum {
	BUFFER_OFFSET_NONE = 0,
	BUFFER_OFFSET_HALF,
	BUFFER_OFFSET_FULL,
}BUFFER_StateTypeDef;

typedef struct {
	uint8_t buff[AUDIO_BUFFER_SIZE];
	uint32_t fptr;
	BUFFER_StateTypeDef state;
}AUDIO_BufferTypeDef;

ALIGN_32BYTES (static AUDIO_BufferTypeDef  buffer_ctl);
static AUDIO_PLAYBACK_StateTypeDef  audio_state;
static uint32_t  AudioStartAddress;
static uint32_t  AudioFileSize;
__IO uint32_t uwVolume = 20;
__IO uint32_t uwPauseEnabledStatus = 0;

static uint32_t AudioFreq[9] = {8000 ,11025, 16000, 22050, 32000, 44100, 48000, 96000, 192000};

// Rec

#define AUDIO_BLOCK_SIZE   ((uint32_t)512)
#define AUDIO_BUFFER_IN    AUDIO_REC_START_ADDR     /* In SDRAM */
#define AUDIO_BUFFER_OUT   (AUDIO_REC_START_ADDR + (AUDIO_BLOCK_SIZE * 2)) /* In SDRAM */

extern uint32_t  audio_rec_buffer_state;
/* USER CODE END PV */

void SystemClock_Config(void);
static void MX_GPIO_Init(void);
static void MX_DMA_Init(void);
static void MX_ADC3_Init(void);
static void MX_I2C1_Init(void);
static void MX_I2C3_Init(void);
static void MX_LTDC_Init(void);
static void MX_RTC_Init(void);
static void MX_SPI2_Init(void);
static void MX_TIM1_Init(void);
static void MX_TIM2_Init(void);
static void MX_TIM3_Init(void);
static void MX_TIM5_Init(void);
static void MX_TIM8_Init(void);
static void MX_USART1_UART_Init(void);
static void MX_USART6_UART_Init(void);
static void MX_ADC1_Init(void);
static void MX_UART7_Init(void);
static void MX_FMC_Init(void);
static void MX_DMA2D_Init(void);
static void MX_SAI2_Init(void);
void StartDefaultTask(void const * argument);
void Audio_demo(void const * argument);
void TS_scan_task(void const * argument);

/* USER CODE BEGIN PFP */

static void Piano_Init(void);
uint8_t CheckForUserInput(void);

// Audio
static uint32_t GetData(void *pdata, uint32_t offset, uint8_t *pbuf, uint32_t NbrOfData);
AUDIO_ErrorTypeDef AUDIO_Start(uint32_t audio_start_address, uint32_t audio_file_size);
static void Audio_SetHint(void);
static void AudioLoopback_SetHint(void);
uint8_t AUDIO_Process(void);

/* USER CODE END PFP */

int main(void)
{
  /* USER CODE BEGIN 1 */
	uint8_t status = 0;
//	char text[50]={};

//	uint32_t potl,potr,joystick_h, joystick_v;
//	ADC_ChannelConfTypeDef sConfig = {0};
//	sConfig.Rank = ADC_REGULAR_RANK_1;
//	sConfig.SamplingTime = ADC_SAMPLETIME_3CYCLES;
  /* USER CODE END 1 */

  /* MCU Configuration--------------------------------------------------------*/

  /* Reset of all peripherals, Initializes the Flash interface and the Systick. */
  HAL_Init();

  /* Configure the system clock */
  SystemClock_Config();

  /* Initialize all configured peripherals */
  MX_GPIO_Init();
  MX_DMA_Init();
  MX_ADC3_Init();
  MX_I2C1_Init();
  MX_I2C3_Init();
  MX_LTDC_Init();
  MX_RTC_Init();
  MX_SPI2_Init();
  MX_TIM1_Init();
  MX_TIM2_Init();
  MX_TIM3_Init();
  MX_TIM5_Init();
  MX_TIM8_Init();
  MX_USART1_UART_Init();
  MX_USART6_UART_Init();
  MX_ADC1_Init();
  MX_UART7_Init();
  MX_FMC_Init();
  MX_DMA2D_Init();
  MX_SAI2_Init();
  /* USER CODE BEGIN 2 */
  BSP_LCD_Init();
  BSP_LCD_LayerDefaultInit(0, LCD_FB_START_ADDRESS);
  BSP_LCD_LayerDefaultInit(1, LCD_FB_START_ADDRESS+ BSP_LCD_GetXSize()*BSP_LCD_GetYSize()*4);
  BSP_LCD_DisplayOn();
  BSP_LCD_SelectLayer(1);

  Piano_Init();

  status = BSP_TS_Init(BSP_LCD_GetXSize(), BSP_LCD_GetYSize());
  if (status != TS_OK)
  {
	  BSP_LCD_SetBackColor(LCD_COLOR_WHITE);
	  BSP_LCD_SetTextColor(LCD_COLOR_RED);
	  BSP_LCD_DisplayStringAt(0, BSP_LCD_GetYSize() - 95, (uint8_t *)"ERROR", CENTER_MODE);
	  BSP_LCD_DisplayStringAt(0, BSP_LCD_GetYSize() - 80, (uint8_t *)"Touchscreen cannot be initialized", CENTER_MODE);
  }
  //BSP_TS_ITConfig();

  /* USER CODE END 2 */

  /* Create the queue(s) */
  /* definition and creation of TS_pos */
  osMessageQDef(TS_pos, 2, uint16_t);
  TS_posHandle = osMessageCreate(osMessageQ(TS_pos), NULL);

  /* Create the thread(s) */
  /* definition and creation of defaultTask */
  osThreadDef(defaultTask, StartDefaultTask, osPriorityIdle, 0, 128);
  defaultTaskHandle = osThreadCreate(osThread(defaultTask), NULL);

  /* definition and creation of Audio */
  osThreadDef(Audio, Audio_demo, osPriorityAboveNormal, 0, 1024);
  AudioHandle = osThreadCreate(osThread(Audio), NULL);

  /* definition and creation of TS_scan */
  osThreadDef(TS_scan, TS_scan_task, osPriorityNormal, 0, 128);
  TS_scanHandle = osThreadCreate(osThread(TS_scan), NULL);

  /* Start scheduler */
  osKernelStart();

  /* We should never get here as control is now taken by the scheduler */
  /* Infinite loop */
  /* USER CODE BEGIN WHILE */
  while (1)
  {
//	  HAL_GPIO_WritePin(LED13_GPIO_Port,LED13_Pin,HAL_GPIO_ReadPin(BP1_GPIO_Port,BP1_Pin));
//	  HAL_GPIO_WritePin(LED14_GPIO_Port,LED14_Pin,HAL_GPIO_ReadPin(BP2_GPIO_Port,BP2_Pin));
//	  sprintf(text,"BP1 : %d",HAL_GPIO_ReadPin(BP1_GPIO_Port,BP1_Pin));
//	  BSP_LCD_DisplayStringAtLine(5,(uint8_t*) text);
//
//	  sConfig.Channel = ADC_CHANNEL_6;
//	  HAL_ADC_ConfigChannel(&hadc3, &sConfig);
//	  HAL_ADC_Start(&hadc3);
//	  while(HAL_ADC_PollForConversion(&hadc3, 100)!=HAL_OK);
//	  potr = HAL_ADC_GetValue(&hadc3);
//
//	  sConfig.Channel = ADC_CHANNEL_7;
//	  HAL_ADC_ConfigChannel(&hadc3, &sConfig);
//	  HAL_ADC_Start(&hadc3);
//	  while(HAL_ADC_PollForConversion(&hadc3, 100)!=HAL_OK);
//	  potl = HAL_ADC_GetValue(&hadc3);
//
//	  sConfig.Channel = ADC_CHANNEL_8;
//	  HAL_ADC_ConfigChannel(&hadc3, &sConfig);
//	  HAL_ADC_Start(&hadc3);
//	  while(HAL_ADC_PollForConversion(&hadc3, 100)!=HAL_OK);
//	  joystick_v = HAL_ADC_GetValue(&hadc3);
//
//	  HAL_ADC_Start(&hadc1);
//	  while(HAL_ADC_PollForConversion(&hadc1, 100)!=HAL_OK);
//	  joystick_h = HAL_ADC_GetValue(&hadc1);
//
//	  sprintf(text,"POTL : %4u POTR : %4u joy_v : %4u joy_h : %4u",(uint)potl,(uint)potr,(uint)joystick_v,(uint)joystick_h);
//	  BSP_LCD_DisplayStringAtLine(9,(uint8_t*) text);
//
//	  BSP_TS_GetState(&TS_State);
//	  if(TS_State.touchDetected){
//		  BSP_LCD_FillCircle(TS_State.touchX[0],TS_State.touchY[0],4);
//	  }
    /* USER CODE END WHILE */

  }
}

void SystemClock_Config(void)
{
  RCC_OscInitTypeDef RCC_OscInitStruct = {0};
  RCC_ClkInitTypeDef RCC_ClkInitStruct = {0};
  RCC_PeriphCLKInitTypeDef PeriphClkInitStruct = {0};

  /** Configure LSE Drive Capability
  */
  HAL_PWR_EnableBkUpAccess();
  /** Configure the main internal regulator output voltage
  */
  __HAL_RCC_PWR_CLK_ENABLE();
  __HAL_PWR_VOLTAGESCALING_CONFIG(PWR_REGULATOR_VOLTAGE_SCALE1);
  /** Initializes the RCC Oscillators according to the specified parameters
  * in the RCC_OscInitTypeDef structure.
  */
  RCC_OscInitStruct.OscillatorType = RCC_OSCILLATORTYPE_LSI|RCC_OSCILLATORTYPE_HSE;
  RCC_OscInitStruct.HSEState = RCC_HSE_ON;
  RCC_OscInitStruct.LSIState = RCC_LSI_ON;
  RCC_OscInitStruct.PLL.PLLState = RCC_PLL_ON;
  RCC_OscInitStruct.PLL.PLLSource = RCC_PLLSOURCE_HSE;
  RCC_OscInitStruct.PLL.PLLM = 25;
  RCC_OscInitStruct.PLL.PLLN = 400;
  RCC_OscInitStruct.PLL.PLLP = RCC_PLLP_DIV2;
  RCC_OscInitStruct.PLL.PLLQ = 9;
  if (HAL_RCC_OscConfig(&RCC_OscInitStruct) != HAL_OK)
  {
    Error_Handler();
  }
  /** Activate the Over-Drive mode
  */
  if (HAL_PWREx_EnableOverDrive() != HAL_OK)
  {
    Error_Handler();
  }
  /** Initializes the CPU, AHB and APB buses clocks
  */
  RCC_ClkInitStruct.ClockType = RCC_CLOCKTYPE_HCLK|RCC_CLOCKTYPE_SYSCLK
                              |RCC_CLOCKTYPE_PCLK1|RCC_CLOCKTYPE_PCLK2;
  RCC_ClkInitStruct.SYSCLKSource = RCC_SYSCLKSOURCE_PLLCLK;
  RCC_ClkInitStruct.AHBCLKDivider = RCC_SYSCLK_DIV1;
  RCC_ClkInitStruct.APB1CLKDivider = RCC_HCLK_DIV4;
  RCC_ClkInitStruct.APB2CLKDivider = RCC_HCLK_DIV2;

  if (HAL_RCC_ClockConfig(&RCC_ClkInitStruct, FLASH_LATENCY_6) != HAL_OK)
  {
    Error_Handler();
  }
  PeriphClkInitStruct.PeriphClockSelection = RCC_PERIPHCLK_LTDC|RCC_PERIPHCLK_RTC
                              |RCC_PERIPHCLK_USART1|RCC_PERIPHCLK_USART6
                              |RCC_PERIPHCLK_UART7|RCC_PERIPHCLK_SAI2
                              |RCC_PERIPHCLK_I2C1|RCC_PERIPHCLK_I2C3;
  PeriphClkInitStruct.PLLSAI.PLLSAIN = 384;
  PeriphClkInitStruct.PLLSAI.PLLSAIR = 5;
  PeriphClkInitStruct.PLLSAI.PLLSAIQ = 2;
  PeriphClkInitStruct.PLLSAI.PLLSAIP = RCC_PLLSAIP_DIV8;
  PeriphClkInitStruct.PLLSAIDivQ = 1;
  PeriphClkInitStruct.PLLSAIDivR = RCC_PLLSAIDIVR_8;
  PeriphClkInitStruct.RTCClockSelection = RCC_RTCCLKSOURCE_LSI;
  PeriphClkInitStruct.Sai2ClockSelection = RCC_SAI2CLKSOURCE_PLLSAI;
  PeriphClkInitStruct.Usart1ClockSelection = RCC_USART1CLKSOURCE_PCLK2;
  PeriphClkInitStruct.Usart6ClockSelection = RCC_USART6CLKSOURCE_PCLK2;
  PeriphClkInitStruct.Uart7ClockSelection = RCC_UART7CLKSOURCE_PCLK1;
  PeriphClkInitStruct.I2c1ClockSelection = RCC_I2C1CLKSOURCE_PCLK1;
  PeriphClkInitStruct.I2c3ClockSelection = RCC_I2C3CLKSOURCE_PCLK1;
  if (HAL_RCCEx_PeriphCLKConfig(&PeriphClkInitStruct) != HAL_OK)
  {
    Error_Handler();
  }
}

static void MX_ADC1_Init(void)
{

  ADC_ChannelConfTypeDef sConfig = {0};

  /** Configure the global features of the ADC (Clock, Resolution, Data Alignment and number of conversion)
  */
  hadc1.Instance = ADC1;
  hadc1.Init.ClockPrescaler = ADC_CLOCK_SYNC_PCLK_DIV4;
  hadc1.Init.Resolution = ADC_RESOLUTION_12B;
  hadc1.Init.ScanConvMode = ADC_SCAN_DISABLE;
  hadc1.Init.ContinuousConvMode = DISABLE;
  hadc1.Init.DiscontinuousConvMode = DISABLE;
  hadc1.Init.ExternalTrigConvEdge = ADC_EXTERNALTRIGCONVEDGE_NONE;
  hadc1.Init.ExternalTrigConv = ADC_SOFTWARE_START;
  hadc1.Init.DataAlign = ADC_DATAALIGN_RIGHT;
  hadc1.Init.NbrOfConversion = 1;
  hadc1.Init.DMAContinuousRequests = DISABLE;
  hadc1.Init.EOCSelection = ADC_EOC_SINGLE_CONV;
  if (HAL_ADC_Init(&hadc1) != HAL_OK)
  {
    Error_Handler();
  }
  /** Configure for the selected ADC regular channel its corresponding rank in the sequencer and its sample time.
  */
  sConfig.Channel = ADC_CHANNEL_0;
  sConfig.Rank = ADC_REGULAR_RANK_1;
  sConfig.SamplingTime = ADC_SAMPLETIME_3CYCLES;
  if (HAL_ADC_ConfigChannel(&hadc1, &sConfig) != HAL_OK)
  {
    Error_Handler();
  }

}

static void MX_ADC3_Init(void)
{

  ADC_ChannelConfTypeDef sConfig = {0};

  /** Configure the global features of the ADC (Clock, Resolution, Data Alignment and number of conversion)
  */
  hadc3.Instance = ADC3;
  hadc3.Init.ClockPrescaler = ADC_CLOCK_SYNC_PCLK_DIV4;
  hadc3.Init.Resolution = ADC_RESOLUTION_12B;
  hadc3.Init.ScanConvMode = ADC_SCAN_DISABLE;
  hadc3.Init.ContinuousConvMode = DISABLE;
  hadc3.Init.DiscontinuousConvMode = DISABLE;
  hadc3.Init.ExternalTrigConvEdge = ADC_EXTERNALTRIGCONVEDGE_NONE;
  hadc3.Init.ExternalTrigConv = ADC_SOFTWARE_START;
  hadc3.Init.DataAlign = ADC_DATAALIGN_RIGHT;
  hadc3.Init.NbrOfConversion = 1;
  hadc3.Init.DMAContinuousRequests = DISABLE;
  hadc3.Init.EOCSelection = ADC_EOC_SINGLE_CONV;
  if (HAL_ADC_Init(&hadc3) != HAL_OK)
  {
    Error_Handler();
  }
  /** Configure for the selected ADC regular channel its corresponding rank in the sequencer and its sample time.
  */
  sConfig.Channel = ADC_CHANNEL_6;
  sConfig.Rank = ADC_REGULAR_RANK_1;
  sConfig.SamplingTime = ADC_SAMPLETIME_3CYCLES;
  if (HAL_ADC_ConfigChannel(&hadc3, &sConfig) != HAL_OK)
  {
    Error_Handler();
  }

}

static void MX_DMA2D_Init(void)
{

  hdma2d.Instance = DMA2D;
  hdma2d.Init.Mode = DMA2D_M2M;
  hdma2d.Init.ColorMode = DMA2D_OUTPUT_ARGB8888;
  hdma2d.Init.OutputOffset = 0;
  hdma2d.LayerCfg[1].InputOffset = 0;
  hdma2d.LayerCfg[1].InputColorMode = DMA2D_INPUT_ARGB8888;
  hdma2d.LayerCfg[1].AlphaMode = DMA2D_NO_MODIF_ALPHA;
  hdma2d.LayerCfg[1].InputAlpha = 0;
  if (HAL_DMA2D_Init(&hdma2d) != HAL_OK)
  {
    Error_Handler();
  }
  if (HAL_DMA2D_ConfigLayer(&hdma2d, 1) != HAL_OK)
  {
    Error_Handler();
  }

}

static void MX_I2C1_Init(void)
{

  hi2c1.Instance = I2C1;
  hi2c1.Init.Timing = 0x00C0EAFF;
  hi2c1.Init.OwnAddress1 = 0;
  hi2c1.Init.AddressingMode = I2C_ADDRESSINGMODE_7BIT;
  hi2c1.Init.DualAddressMode = I2C_DUALADDRESS_DISABLE;
  hi2c1.Init.OwnAddress2 = 0;
  hi2c1.Init.OwnAddress2Masks = I2C_OA2_NOMASK;
  hi2c1.Init.GeneralCallMode = I2C_GENERALCALL_DISABLE;
  hi2c1.Init.NoStretchMode = I2C_NOSTRETCH_DISABLE;
  if (HAL_I2C_Init(&hi2c1) != HAL_OK)
  {
    Error_Handler();
  }
  /** Configure Analogue filter
  */
  if (HAL_I2CEx_ConfigAnalogFilter(&hi2c1, I2C_ANALOGFILTER_ENABLE) != HAL_OK)
  {
    Error_Handler();
  }
  /** Configure Digital filter
  */
  if (HAL_I2CEx_ConfigDigitalFilter(&hi2c1, 0) != HAL_OK)
  {
    Error_Handler();
  }

}

static void MX_I2C3_Init(void)
{

  hi2c3.Instance = I2C3;
  hi2c3.Init.Timing = 0x00C0EAFF;
  hi2c3.Init.OwnAddress1 = 0;
  hi2c3.Init.AddressingMode = I2C_ADDRESSINGMODE_7BIT;
  hi2c3.Init.DualAddressMode = I2C_DUALADDRESS_DISABLE;
  hi2c3.Init.OwnAddress2 = 0;
  hi2c3.Init.OwnAddress2Masks = I2C_OA2_NOMASK;
  hi2c3.Init.GeneralCallMode = I2C_GENERALCALL_DISABLE;
  hi2c3.Init.NoStretchMode = I2C_NOSTRETCH_DISABLE;
  if (HAL_I2C_Init(&hi2c3) != HAL_OK)
  {
    Error_Handler();
  }
  /** Configure Analogue filter
  */
  if (HAL_I2CEx_ConfigAnalogFilter(&hi2c3, I2C_ANALOGFILTER_ENABLE) != HAL_OK)
  {
    Error_Handler();
  }
  /** Configure Digital filter
  */
  if (HAL_I2CEx_ConfigDigitalFilter(&hi2c3, 0) != HAL_OK)
  {
    Error_Handler();
  }

}

static void MX_LTDC_Init(void)
{

  LTDC_LayerCfgTypeDef pLayerCfg = {0};

  hltdc.Instance = LTDC;
  hltdc.Init.HSPolarity = LTDC_HSPOLARITY_AL;
  hltdc.Init.VSPolarity = LTDC_VSPOLARITY_AL;
  hltdc.Init.DEPolarity = LTDC_DEPOLARITY_AL;
  hltdc.Init.PCPolarity = LTDC_PCPOLARITY_IPC;
  hltdc.Init.HorizontalSync = 40;
  hltdc.Init.VerticalSync = 9;
  hltdc.Init.AccumulatedHBP = 53;
  hltdc.Init.AccumulatedVBP = 11;
  hltdc.Init.AccumulatedActiveW = 533;
  hltdc.Init.AccumulatedActiveH = 283;
  hltdc.Init.TotalWidth = 565;
  hltdc.Init.TotalHeigh = 285;
  hltdc.Init.Backcolor.Blue = 0;
  hltdc.Init.Backcolor.Green = 0;
  hltdc.Init.Backcolor.Red = 0;
  if (HAL_LTDC_Init(&hltdc) != HAL_OK)
  {
    Error_Handler();
  }
  pLayerCfg.WindowX0 = 0;
  pLayerCfg.WindowX1 = 480;
  pLayerCfg.WindowY0 = 0;
  pLayerCfg.WindowY1 = 272;
  pLayerCfg.PixelFormat = LTDC_PIXEL_FORMAT_RGB565;
  pLayerCfg.Alpha = 255;
  pLayerCfg.Alpha0 = 0;
  pLayerCfg.BlendingFactor1 = LTDC_BLENDING_FACTOR1_PAxCA;
  pLayerCfg.BlendingFactor2 = LTDC_BLENDING_FACTOR2_PAxCA;
  pLayerCfg.FBStartAdress = 0xC0000000;
  pLayerCfg.ImageWidth = 480;
  pLayerCfg.ImageHeight = 272;
  pLayerCfg.Backcolor.Blue = 0;
  pLayerCfg.Backcolor.Green = 0;
  pLayerCfg.Backcolor.Red = 0;
  if (HAL_LTDC_ConfigLayer(&hltdc, &pLayerCfg, 0) != HAL_OK)
  {
    Error_Handler();
  }

}

static void MX_RTC_Init(void)
{

  RTC_TimeTypeDef sTime = {0};
  RTC_DateTypeDef sDate = {0};
  RTC_AlarmTypeDef sAlarm = {0};

  /** Initialize RTC Only
  */
  hrtc.Instance = RTC;
  hrtc.Init.HourFormat = RTC_HOURFORMAT_24;
  hrtc.Init.AsynchPrediv = 127;
  hrtc.Init.SynchPrediv = 255;
  hrtc.Init.OutPut = RTC_OUTPUT_DISABLE;
  hrtc.Init.OutPutPolarity = RTC_OUTPUT_POLARITY_HIGH;
  hrtc.Init.OutPutType = RTC_OUTPUT_TYPE_OPENDRAIN;
  if (HAL_RTC_Init(&hrtc) != HAL_OK)
  {
    Error_Handler();
  }

  /** Initialize RTC and set the Time and Date
  */
  sTime.Hours = 0x0;
  sTime.Minutes = 0x0;
  sTime.Seconds = 0x0;
  sTime.DayLightSaving = RTC_DAYLIGHTSAVING_NONE;
  sTime.StoreOperation = RTC_STOREOPERATION_RESET;
  if (HAL_RTC_SetTime(&hrtc, &sTime, RTC_FORMAT_BCD) != HAL_OK)
  {
    Error_Handler();
  }
  sDate.WeekDay = RTC_WEEKDAY_MONDAY;
  sDate.Month = RTC_MONTH_JANUARY;
  sDate.Date = 0x1;
  sDate.Year = 0x0;
  if (HAL_RTC_SetDate(&hrtc, &sDate, RTC_FORMAT_BCD) != HAL_OK)
  {
    Error_Handler();
  }
  /** Enable the Alarm A
  */
  sAlarm.AlarmTime.Hours = 0x0;
  sAlarm.AlarmTime.Minutes = 0x0;
  sAlarm.AlarmTime.Seconds = 0x0;
  sAlarm.AlarmTime.SubSeconds = 0x0;
  sAlarm.AlarmTime.DayLightSaving = RTC_DAYLIGHTSAVING_NONE;
  sAlarm.AlarmTime.StoreOperation = RTC_STOREOPERATION_RESET;
  sAlarm.AlarmMask = RTC_ALARMMASK_NONE;
  sAlarm.AlarmSubSecondMask = RTC_ALARMSUBSECONDMASK_ALL;
  sAlarm.AlarmDateWeekDaySel = RTC_ALARMDATEWEEKDAYSEL_DATE;
  sAlarm.AlarmDateWeekDay = 0x1;
  sAlarm.Alarm = RTC_ALARM_A;
  if (HAL_RTC_SetAlarm(&hrtc, &sAlarm, RTC_FORMAT_BCD) != HAL_OK)
  {
    Error_Handler();
  }
  /** Enable the Alarm B
  */
  sAlarm.Alarm = RTC_ALARM_B;
  if (HAL_RTC_SetAlarm(&hrtc, &sAlarm, RTC_FORMAT_BCD) != HAL_OK)
  {
    Error_Handler();
  }
  /** Enable the TimeStamp
  */
  if (HAL_RTCEx_SetTimeStamp(&hrtc, RTC_TIMESTAMPEDGE_RISING, RTC_TIMESTAMPPIN_POS1) != HAL_OK)
  {
    Error_Handler();
  }

}

static void MX_SAI2_Init(void)
{

  hsai_BlockA2.Instance = SAI2_Block_A;
  hsai_BlockA2.Init.Protocol = SAI_FREE_PROTOCOL;
  hsai_BlockA2.Init.AudioMode = SAI_MODEMASTER_TX;
  hsai_BlockA2.Init.DataSize = SAI_DATASIZE_8;
  hsai_BlockA2.Init.FirstBit = SAI_FIRSTBIT_MSB;
  hsai_BlockA2.Init.ClockStrobing = SAI_CLOCKSTROBING_FALLINGEDGE;
  hsai_BlockA2.Init.Synchro = SAI_ASYNCHRONOUS;
  hsai_BlockA2.Init.OutputDrive = SAI_OUTPUTDRIVE_DISABLE;
  hsai_BlockA2.Init.NoDivider = SAI_MASTERDIVIDER_ENABLE;
  hsai_BlockA2.Init.FIFOThreshold = SAI_FIFOTHRESHOLD_EMPTY;
  hsai_BlockA2.Init.AudioFrequency = SAI_AUDIO_FREQUENCY_192K;
  hsai_BlockA2.Init.SynchroExt = SAI_SYNCEXT_DISABLE;
  hsai_BlockA2.Init.MonoStereoMode = SAI_STEREOMODE;
  hsai_BlockA2.Init.CompandingMode = SAI_NOCOMPANDING;
  hsai_BlockA2.Init.TriState = SAI_OUTPUT_NOTRELEASED;
  hsai_BlockA2.FrameInit.FrameLength = 8;
  hsai_BlockA2.FrameInit.ActiveFrameLength = 1;
  hsai_BlockA2.FrameInit.FSDefinition = SAI_FS_STARTFRAME;
  hsai_BlockA2.FrameInit.FSPolarity = SAI_FS_ACTIVE_LOW;
  hsai_BlockA2.FrameInit.FSOffset = SAI_FS_FIRSTBIT;
  hsai_BlockA2.SlotInit.FirstBitOffset = 0;
  hsai_BlockA2.SlotInit.SlotSize = SAI_SLOTSIZE_DATASIZE;
  hsai_BlockA2.SlotInit.SlotNumber = 1;
  hsai_BlockA2.SlotInit.SlotActive = 0x00000000;
  if (HAL_SAI_Init(&hsai_BlockA2) != HAL_OK)
  {
    Error_Handler();
  }

}

static void MX_SPI2_Init(void)
{

  /* SPI2 parameter configuration*/
  hspi2.Instance = SPI2;
  hspi2.Init.Mode = SPI_MODE_MASTER;
  hspi2.Init.Direction = SPI_DIRECTION_2LINES;
  hspi2.Init.DataSize = SPI_DATASIZE_4BIT;
  hspi2.Init.CLKPolarity = SPI_POLARITY_LOW;
  hspi2.Init.CLKPhase = SPI_PHASE_1EDGE;
  hspi2.Init.NSS = SPI_NSS_HARD_OUTPUT;
  hspi2.Init.BaudRatePrescaler = SPI_BAUDRATEPRESCALER_2;
  hspi2.Init.FirstBit = SPI_FIRSTBIT_MSB;
  hspi2.Init.TIMode = SPI_TIMODE_DISABLE;
  hspi2.Init.CRCCalculation = SPI_CRCCALCULATION_DISABLE;
  hspi2.Init.CRCPolynomial = 7;
  hspi2.Init.CRCLength = SPI_CRC_LENGTH_DATASIZE;
  hspi2.Init.NSSPMode = SPI_NSS_PULSE_ENABLE;
  if (HAL_SPI_Init(&hspi2) != HAL_OK)
  {
    Error_Handler();
  }

}

static void MX_TIM1_Init(void)
{

  TIM_ClockConfigTypeDef sClockSourceConfig = {0};
  TIM_MasterConfigTypeDef sMasterConfig = {0};

  htim1.Instance = TIM1;
  htim1.Init.Prescaler = 0;
  htim1.Init.CounterMode = TIM_COUNTERMODE_UP;
  htim1.Init.Period = 65535;
  htim1.Init.ClockDivision = TIM_CLOCKDIVISION_DIV1;
  htim1.Init.RepetitionCounter = 0;
  htim1.Init.AutoReloadPreload = TIM_AUTORELOAD_PRELOAD_DISABLE;
  if (HAL_TIM_Base_Init(&htim1) != HAL_OK)
  {
    Error_Handler();
  }
  sClockSourceConfig.ClockSource = TIM_CLOCKSOURCE_INTERNAL;
  if (HAL_TIM_ConfigClockSource(&htim1, &sClockSourceConfig) != HAL_OK)
  {
    Error_Handler();
  }
  sMasterConfig.MasterOutputTrigger = TIM_TRGO_RESET;
  sMasterConfig.MasterOutputTrigger2 = TIM_TRGO2_RESET;
  sMasterConfig.MasterSlaveMode = TIM_MASTERSLAVEMODE_DISABLE;
  if (HAL_TIMEx_MasterConfigSynchronization(&htim1, &sMasterConfig) != HAL_OK)
  {
    Error_Handler();
  }

}

static void MX_TIM2_Init(void)
{

  TIM_ClockConfigTypeDef sClockSourceConfig = {0};
  TIM_MasterConfigTypeDef sMasterConfig = {0};

  htim2.Instance = TIM2;
  htim2.Init.Prescaler = 0;
  htim2.Init.CounterMode = TIM_COUNTERMODE_UP;
  htim2.Init.Period = 4294967295;
  htim2.Init.ClockDivision = TIM_CLOCKDIVISION_DIV1;
  htim2.Init.AutoReloadPreload = TIM_AUTORELOAD_PRELOAD_DISABLE;
  if (HAL_TIM_Base_Init(&htim2) != HAL_OK)
  {
    Error_Handler();
  }
  sClockSourceConfig.ClockSource = TIM_CLOCKSOURCE_INTERNAL;
  if (HAL_TIM_ConfigClockSource(&htim2, &sClockSourceConfig) != HAL_OK)
  {
    Error_Handler();
  }
  sMasterConfig.MasterOutputTrigger = TIM_TRGO_RESET;
  sMasterConfig.MasterSlaveMode = TIM_MASTERSLAVEMODE_DISABLE;
  if (HAL_TIMEx_MasterConfigSynchronization(&htim2, &sMasterConfig) != HAL_OK)
  {
    Error_Handler();
  }

}

static void MX_TIM3_Init(void)
{

  TIM_ClockConfigTypeDef sClockSourceConfig = {0};
  TIM_SlaveConfigTypeDef sSlaveConfig = {0};
  TIM_MasterConfigTypeDef sMasterConfig = {0};
  TIM_OC_InitTypeDef sConfigOC = {0};

  htim3.Instance = TIM3;
  htim3.Init.Prescaler = 0;
  htim3.Init.CounterMode = TIM_COUNTERMODE_UP;
  htim3.Init.Period = 65535;
  htim3.Init.ClockDivision = TIM_CLOCKDIVISION_DIV1;
  htim3.Init.AutoReloadPreload = TIM_AUTORELOAD_PRELOAD_DISABLE;
  if (HAL_TIM_Base_Init(&htim3) != HAL_OK)
  {
    Error_Handler();
  }
  sClockSourceConfig.ClockSource = TIM_CLOCKSOURCE_INTERNAL;
  if (HAL_TIM_ConfigClockSource(&htim3, &sClockSourceConfig) != HAL_OK)
  {
    Error_Handler();
  }
  if (HAL_TIM_PWM_Init(&htim3) != HAL_OK)
  {
    Error_Handler();
  }
  sSlaveConfig.SlaveMode = TIM_SLAVEMODE_DISABLE;
  sSlaveConfig.InputTrigger = TIM_TS_ITR0;
  if (HAL_TIM_SlaveConfigSynchro(&htim3, &sSlaveConfig) != HAL_OK)
  {
    Error_Handler();
  }
  sMasterConfig.MasterOutputTrigger = TIM_TRGO_RESET;
  sMasterConfig.MasterSlaveMode = TIM_MASTERSLAVEMODE_DISABLE;
  if (HAL_TIMEx_MasterConfigSynchronization(&htim3, &sMasterConfig) != HAL_OK)
  {
    Error_Handler();
  }
  sConfigOC.OCMode = TIM_OCMODE_PWM1;
  sConfigOC.Pulse = 0;
  sConfigOC.OCPolarity = TIM_OCPOLARITY_HIGH;
  sConfigOC.OCFastMode = TIM_OCFAST_DISABLE;
  if (HAL_TIM_PWM_ConfigChannel(&htim3, &sConfigOC, TIM_CHANNEL_1) != HAL_OK)
  {
    Error_Handler();
  }
  HAL_TIM_MspPostInit(&htim3);

}

static void MX_TIM5_Init(void)
{

  TIM_ClockConfigTypeDef sClockSourceConfig = {0};
  TIM_MasterConfigTypeDef sMasterConfig = {0};

  htim5.Instance = TIM5;
  htim5.Init.Prescaler = 0;
  htim5.Init.CounterMode = TIM_COUNTERMODE_UP;
  htim5.Init.Period = 4294967295;
  htim5.Init.ClockDivision = TIM_CLOCKDIVISION_DIV1;
  htim5.Init.AutoReloadPreload = TIM_AUTORELOAD_PRELOAD_DISABLE;
  if (HAL_TIM_Base_Init(&htim5) != HAL_OK)
  {
    Error_Handler();
  }
  sClockSourceConfig.ClockSource = TIM_CLOCKSOURCE_INTERNAL;
  if (HAL_TIM_ConfigClockSource(&htim5, &sClockSourceConfig) != HAL_OK)
  {
    Error_Handler();
  }
  sMasterConfig.MasterOutputTrigger = TIM_TRGO_RESET;
  sMasterConfig.MasterSlaveMode = TIM_MASTERSLAVEMODE_DISABLE;
  if (HAL_TIMEx_MasterConfigSynchronization(&htim5, &sMasterConfig) != HAL_OK)
  {
    Error_Handler();
  }

}

static void MX_TIM8_Init(void)
{

  TIM_ClockConfigTypeDef sClockSourceConfig = {0};
  TIM_MasterConfigTypeDef sMasterConfig = {0};
  TIM_OC_InitTypeDef sConfigOC = {0};
  TIM_BreakDeadTimeConfigTypeDef sBreakDeadTimeConfig = {0};

  htim8.Instance = TIM8;
  htim8.Init.Prescaler = 0;
  htim8.Init.CounterMode = TIM_COUNTERMODE_UP;
  htim8.Init.Period = 65535;
  htim8.Init.ClockDivision = TIM_CLOCKDIVISION_DIV1;
  htim8.Init.RepetitionCounter = 0;
  htim8.Init.AutoReloadPreload = TIM_AUTORELOAD_PRELOAD_DISABLE;
  if (HAL_TIM_Base_Init(&htim8) != HAL_OK)
  {
    Error_Handler();
  }
  sClockSourceConfig.ClockSource = TIM_CLOCKSOURCE_INTERNAL;
  if (HAL_TIM_ConfigClockSource(&htim8, &sClockSourceConfig) != HAL_OK)
  {
    Error_Handler();
  }
  if (HAL_TIM_PWM_Init(&htim8) != HAL_OK)
  {
    Error_Handler();
  }
  sMasterConfig.MasterOutputTrigger = TIM_TRGO_RESET;
  sMasterConfig.MasterOutputTrigger2 = TIM_TRGO2_RESET;
  sMasterConfig.MasterSlaveMode = TIM_MASTERSLAVEMODE_DISABLE;
  if (HAL_TIMEx_MasterConfigSynchronization(&htim8, &sMasterConfig) != HAL_OK)
  {
    Error_Handler();
  }
  sConfigOC.OCMode = TIM_OCMODE_PWM1;
  sConfigOC.Pulse = 0;
  sConfigOC.OCPolarity = TIM_OCPOLARITY_HIGH;
  sConfigOC.OCFastMode = TIM_OCFAST_DISABLE;
  sConfigOC.OCIdleState = TIM_OCIDLESTATE_RESET;
  sConfigOC.OCNIdleState = TIM_OCNIDLESTATE_RESET;
  if (HAL_TIM_PWM_ConfigChannel(&htim8, &sConfigOC, TIM_CHANNEL_4) != HAL_OK)
  {
    Error_Handler();
  }
  sBreakDeadTimeConfig.OffStateRunMode = TIM_OSSR_DISABLE;
  sBreakDeadTimeConfig.OffStateIDLEMode = TIM_OSSI_DISABLE;
  sBreakDeadTimeConfig.LockLevel = TIM_LOCKLEVEL_OFF;
  sBreakDeadTimeConfig.DeadTime = 0;
  sBreakDeadTimeConfig.BreakState = TIM_BREAK_DISABLE;
  sBreakDeadTimeConfig.BreakPolarity = TIM_BREAKPOLARITY_HIGH;
  sBreakDeadTimeConfig.BreakFilter = 0;
  sBreakDeadTimeConfig.Break2State = TIM_BREAK2_DISABLE;
  sBreakDeadTimeConfig.Break2Polarity = TIM_BREAK2POLARITY_HIGH;
  sBreakDeadTimeConfig.Break2Filter = 0;
  sBreakDeadTimeConfig.AutomaticOutput = TIM_AUTOMATICOUTPUT_DISABLE;
  if (HAL_TIMEx_ConfigBreakDeadTime(&htim8, &sBreakDeadTimeConfig) != HAL_OK)
  {
    Error_Handler();
  }
  HAL_TIM_MspPostInit(&htim8);

}

static void MX_UART7_Init(void)
{

  huart7.Instance = UART7;
  huart7.Init.BaudRate = 115200;
  huart7.Init.WordLength = UART_WORDLENGTH_8B;
  huart7.Init.StopBits = UART_STOPBITS_1;
  huart7.Init.Parity = UART_PARITY_NONE;
  huart7.Init.Mode = UART_MODE_TX_RX;
  huart7.Init.HwFlowCtl = UART_HWCONTROL_NONE;
  huart7.Init.OverSampling = UART_OVERSAMPLING_16;
  huart7.Init.OneBitSampling = UART_ONE_BIT_SAMPLE_DISABLE;
  huart7.AdvancedInit.AdvFeatureInit = UART_ADVFEATURE_NO_INIT;
  if (HAL_UART_Init(&huart7) != HAL_OK)
  {
    Error_Handler();
  }

}

static void MX_USART1_UART_Init(void)
{

  huart1.Instance = USART1;
  huart1.Init.BaudRate = 115200;
  huart1.Init.WordLength = UART_WORDLENGTH_8B;
  huart1.Init.StopBits = UART_STOPBITS_1;
  huart1.Init.Parity = UART_PARITY_NONE;
  huart1.Init.Mode = UART_MODE_TX_RX;
  huart1.Init.HwFlowCtl = UART_HWCONTROL_NONE;
  huart1.Init.OverSampling = UART_OVERSAMPLING_16;
  huart1.Init.OneBitSampling = UART_ONE_BIT_SAMPLE_DISABLE;
  huart1.AdvancedInit.AdvFeatureInit = UART_ADVFEATURE_NO_INIT;
  if (HAL_UART_Init(&huart1) != HAL_OK)
  {
    Error_Handler();
  }

}

static void MX_USART6_UART_Init(void)
{

  huart6.Instance = USART6;
  huart6.Init.BaudRate = 115200;
  huart6.Init.WordLength = UART_WORDLENGTH_8B;
  huart6.Init.StopBits = UART_STOPBITS_1;
  huart6.Init.Parity = UART_PARITY_NONE;
  huart6.Init.Mode = UART_MODE_TX_RX;
  huart6.Init.HwFlowCtl = UART_HWCONTROL_NONE;
  huart6.Init.OverSampling = UART_OVERSAMPLING_16;
  huart6.Init.OneBitSampling = UART_ONE_BIT_SAMPLE_DISABLE;
  huart6.AdvancedInit.AdvFeatureInit = UART_ADVFEATURE_NO_INIT;
  if (HAL_UART_Init(&huart6) != HAL_OK)
  {
    Error_Handler();
  }

}

static void MX_DMA_Init(void)
{

  /* DMA controller clock enable */
  __HAL_RCC_DMA2_CLK_ENABLE();

  /* DMA interrupt init */
  /* DMA2_Stream4_IRQn interrupt configuration */
  HAL_NVIC_SetPriority(DMA2_Stream4_IRQn, 5, 0);
  HAL_NVIC_EnableIRQ(DMA2_Stream4_IRQn);

}

/* FMC initialization function */
static void MX_FMC_Init(void)
{

  FMC_SDRAM_TimingTypeDef SdramTiming = {0};

  /** Perform the SDRAM1 memory initialization sequence
  */
  hsdram1.Instance = FMC_SDRAM_DEVICE;
  /* hsdram1.Init */
  hsdram1.Init.SDBank = FMC_SDRAM_BANK1;
  hsdram1.Init.ColumnBitsNumber = FMC_SDRAM_COLUMN_BITS_NUM_8;
  hsdram1.Init.RowBitsNumber = FMC_SDRAM_ROW_BITS_NUM_12;
  hsdram1.Init.MemoryDataWidth = FMC_SDRAM_MEM_BUS_WIDTH_16;
  hsdram1.Init.InternalBankNumber = FMC_SDRAM_INTERN_BANKS_NUM_4;
  hsdram1.Init.CASLatency = FMC_SDRAM_CAS_LATENCY_1;
  hsdram1.Init.WriteProtection = FMC_SDRAM_WRITE_PROTECTION_DISABLE;
  hsdram1.Init.SDClockPeriod = FMC_SDRAM_CLOCK_DISABLE;
  hsdram1.Init.ReadBurst = FMC_SDRAM_RBURST_DISABLE;
  hsdram1.Init.ReadPipeDelay = FMC_SDRAM_RPIPE_DELAY_0;
  /* SdramTiming */
  SdramTiming.LoadToActiveDelay = 16;
  SdramTiming.ExitSelfRefreshDelay = 16;
  SdramTiming.SelfRefreshTime = 16;
  SdramTiming.RowCycleDelay = 16;
  SdramTiming.WriteRecoveryTime = 16;
  SdramTiming.RPDelay = 16;
  SdramTiming.RCDDelay = 16;

  if (HAL_SDRAM_Init(&hsdram1, &SdramTiming) != HAL_OK)
  {
    Error_Handler( );
  }

}

static void MX_GPIO_Init(void)
{
  GPIO_InitTypeDef GPIO_InitStruct = {0};

  /* GPIO Ports Clock Enable */
  __HAL_RCC_GPIOE_CLK_ENABLE();
  __HAL_RCC_GPIOB_CLK_ENABLE();
  __HAL_RCC_GPIOA_CLK_ENABLE();
  __HAL_RCC_GPIOG_CLK_ENABLE();
  __HAL_RCC_GPIOJ_CLK_ENABLE();
  __HAL_RCC_GPIOD_CLK_ENABLE();
  __HAL_RCC_GPIOI_CLK_ENABLE();
  __HAL_RCC_GPIOK_CLK_ENABLE();
  __HAL_RCC_GPIOC_CLK_ENABLE();
  __HAL_RCC_GPIOF_CLK_ENABLE();
  __HAL_RCC_GPIOH_CLK_ENABLE();

  /*Configure GPIO pin Output Level */
  HAL_GPIO_WritePin(GPIOE, LED14_Pin|LED15_Pin, GPIO_PIN_RESET);

  /*Configure GPIO pin Output Level */
  HAL_GPIO_WritePin(OTG_FS_PowerSwitchOn_GPIO_Port, OTG_FS_PowerSwitchOn_Pin, GPIO_PIN_SET);

  /*Configure GPIO pin Output Level */
  HAL_GPIO_WritePin(LED16_GPIO_Port, LED16_Pin, GPIO_PIN_RESET);

  /*Configure GPIO pin Output Level */
  HAL_GPIO_WritePin(LED3_GPIO_Port, LED3_Pin, GPIO_PIN_RESET);

  /*Configure GPIO pin Output Level */
  HAL_GPIO_WritePin(LCD_BL_CTRL_GPIO_Port, LCD_BL_CTRL_Pin, GPIO_PIN_SET);

  /*Configure GPIO pin Output Level */
  HAL_GPIO_WritePin(LCD_DISP_GPIO_Port, LCD_DISP_Pin, GPIO_PIN_SET);

  /*Configure GPIO pin Output Level */
  HAL_GPIO_WritePin(GPIOH, LED13_Pin|LED17_Pin|LED11_Pin|LED12_Pin
                          |LED2_Pin|LED18_Pin, GPIO_PIN_RESET);

  /*Configure GPIO pin Output Level */
  HAL_GPIO_WritePin(EXT_RST_GPIO_Port, EXT_RST_Pin, GPIO_PIN_RESET);

  /*Configure GPIO pin : PE3 */
  GPIO_InitStruct.Pin = GPIO_PIN_3;
  GPIO_InitStruct.Mode = GPIO_MODE_INPUT;
  GPIO_InitStruct.Pull = GPIO_NOPULL;
  HAL_GPIO_Init(GPIOE, &GPIO_InitStruct);

  /*Configure GPIO pins : ULPI_D7_Pin ULPI_D6_Pin ULPI_D5_Pin ULPI_D2_Pin
                           ULPI_D1_Pin ULPI_D4_Pin */
  GPIO_InitStruct.Pin = ULPI_D7_Pin|ULPI_D6_Pin|ULPI_D5_Pin|ULPI_D2_Pin
                          |ULPI_D1_Pin|ULPI_D4_Pin;
  GPIO_InitStruct.Mode = GPIO_MODE_AF_PP;
  GPIO_InitStruct.Pull = GPIO_NOPULL;
  GPIO_InitStruct.Speed = GPIO_SPEED_FREQ_VERY_HIGH;
  GPIO_InitStruct.Alternate = GPIO_AF10_OTG_HS;
  HAL_GPIO_Init(GPIOB, &GPIO_InitStruct);

  /*Configure GPIO pins : LED14_Pin LED15_Pin */
  GPIO_InitStruct.Pin = LED14_Pin|LED15_Pin;
  GPIO_InitStruct.Mode = GPIO_MODE_OUTPUT_PP;
  GPIO_InitStruct.Pull = GPIO_NOPULL;
  GPIO_InitStruct.Speed = GPIO_SPEED_FREQ_LOW;
  HAL_GPIO_Init(GPIOE, &GPIO_InitStruct);

  /*Configure GPIO pin : OTG_FS_VBUS_Pin */
  GPIO_InitStruct.Pin = OTG_FS_VBUS_Pin;
  GPIO_InitStruct.Mode = GPIO_MODE_INPUT;
  GPIO_InitStruct.Pull = GPIO_NOPULL;
  HAL_GPIO_Init(OTG_FS_VBUS_GPIO_Port, &GPIO_InitStruct);

  /*Configure GPIO pin : Audio_INT_Pin */
  GPIO_InitStruct.Pin = Audio_INT_Pin;
  GPIO_InitStruct.Mode = GPIO_MODE_EVT_RISING;
  GPIO_InitStruct.Pull = GPIO_NOPULL;
  HAL_GPIO_Init(Audio_INT_GPIO_Port, &GPIO_InitStruct);

  /*Configure GPIO pins : OTG_FS_PowerSwitchOn_Pin LED16_Pin */
  GPIO_InitStruct.Pin = OTG_FS_PowerSwitchOn_Pin|LED16_Pin;
  GPIO_InitStruct.Mode = GPIO_MODE_OUTPUT_PP;
  GPIO_InitStruct.Pull = GPIO_NOPULL;
  GPIO_InitStruct.Speed = GPIO_SPEED_FREQ_LOW;
  HAL_GPIO_Init(GPIOD, &GPIO_InitStruct);

  /*Configure GPIO pins : LED3_Pin LCD_DISP_Pin */
  GPIO_InitStruct.Pin = LED3_Pin|LCD_DISP_Pin;
  GPIO_InitStruct.Mode = GPIO_MODE_OUTPUT_PP;
  GPIO_InitStruct.Pull = GPIO_NOPULL;
  GPIO_InitStruct.Speed = GPIO_SPEED_FREQ_LOW;
  HAL_GPIO_Init(GPIOI, &GPIO_InitStruct);

  /*Configure GPIO pin : uSD_Detect_Pin */
  GPIO_InitStruct.Pin = uSD_Detect_Pin;
  GPIO_InitStruct.Mode = GPIO_MODE_INPUT;
  GPIO_InitStruct.Pull = GPIO_NOPULL;
  HAL_GPIO_Init(uSD_Detect_GPIO_Port, &GPIO_InitStruct);

  /*Configure GPIO pin : LCD_BL_CTRL_Pin */
  GPIO_InitStruct.Pin = LCD_BL_CTRL_Pin;
  GPIO_InitStruct.Mode = GPIO_MODE_OUTPUT_PP;
  GPIO_InitStruct.Pull = GPIO_NOPULL;
  GPIO_InitStruct.Speed = GPIO_SPEED_FREQ_LOW;
  HAL_GPIO_Init(LCD_BL_CTRL_GPIO_Port, &GPIO_InitStruct);

  /*Configure GPIO pin : OTG_FS_OverCurrent_Pin */
  GPIO_InitStruct.Pin = OTG_FS_OverCurrent_Pin;
  GPIO_InitStruct.Mode = GPIO_MODE_INPUT;
  GPIO_InitStruct.Pull = GPIO_NOPULL;
  HAL_GPIO_Init(OTG_FS_OverCurrent_GPIO_Port, &GPIO_InitStruct);

  /*Configure GPIO pins : TP3_Pin NC2_Pin */
  GPIO_InitStruct.Pin = TP3_Pin|NC2_Pin;
  GPIO_InitStruct.Mode = GPIO_MODE_INPUT;
  GPIO_InitStruct.Pull = GPIO_NOPULL;
  HAL_GPIO_Init(GPIOH, &GPIO_InitStruct);

  /*Configure GPIO pins : LED13_Pin LED17_Pin LED11_Pin LED12_Pin
                           LED2_Pin LED18_Pin */
  GPIO_InitStruct.Pin = LED13_Pin|LED17_Pin|LED11_Pin|LED12_Pin
                          |LED2_Pin|LED18_Pin;
  GPIO_InitStruct.Mode = GPIO_MODE_OUTPUT_PP;
  GPIO_InitStruct.Pull = GPIO_NOPULL;
  GPIO_InitStruct.Speed = GPIO_SPEED_FREQ_LOW;
  HAL_GPIO_Init(GPIOH, &GPIO_InitStruct);

  /*Configure GPIO pin : BP1_Pin */
  GPIO_InitStruct.Pin = BP1_Pin;
  GPIO_InitStruct.Mode = GPIO_MODE_INPUT;
  GPIO_InitStruct.Pull = GPIO_NOPULL;
  HAL_GPIO_Init(BP1_GPIO_Port, &GPIO_InitStruct);

  /*Configure GPIO pin : LCD_INT_Pin */
  GPIO_InitStruct.Pin = LCD_INT_Pin;
  GPIO_InitStruct.Mode = GPIO_MODE_EVT_RISING;
  GPIO_InitStruct.Pull = GPIO_NOPULL;
  HAL_GPIO_Init(LCD_INT_GPIO_Port, &GPIO_InitStruct);

  /*Configure GPIO pin : ULPI_NXT_Pin */
  GPIO_InitStruct.Pin = ULPI_NXT_Pin;
  GPIO_InitStruct.Mode = GPIO_MODE_AF_PP;
  GPIO_InitStruct.Pull = GPIO_NOPULL;
  GPIO_InitStruct.Speed = GPIO_SPEED_FREQ_VERY_HIGH;
  GPIO_InitStruct.Alternate = GPIO_AF10_OTG_HS;
  HAL_GPIO_Init(ULPI_NXT_GPIO_Port, &GPIO_InitStruct);

  /*Configure GPIO pins : BP_JOYSTICK_Pin RMII_RXER_Pin */
  GPIO_InitStruct.Pin = BP_JOYSTICK_Pin|RMII_RXER_Pin;
  GPIO_InitStruct.Mode = GPIO_MODE_INPUT;
  GPIO_InitStruct.Pull = GPIO_NOPULL;
  HAL_GPIO_Init(GPIOG, &GPIO_InitStruct);

  /*Configure GPIO pins : ULPI_STP_Pin ULPI_DIR_Pin */
  GPIO_InitStruct.Pin = ULPI_STP_Pin|ULPI_DIR_Pin;
  GPIO_InitStruct.Mode = GPIO_MODE_AF_PP;
  GPIO_InitStruct.Pull = GPIO_NOPULL;
  GPIO_InitStruct.Speed = GPIO_SPEED_FREQ_VERY_HIGH;
  GPIO_InitStruct.Alternate = GPIO_AF10_OTG_HS;
  HAL_GPIO_Init(GPIOC, &GPIO_InitStruct);

  /*Configure GPIO pin : EXT_RST_Pin */
  GPIO_InitStruct.Pin = EXT_RST_Pin;
  GPIO_InitStruct.Mode = GPIO_MODE_OUTPUT_PP;
  GPIO_InitStruct.Pull = GPIO_NOPULL;
  GPIO_InitStruct.Speed = GPIO_SPEED_FREQ_LOW;
  HAL_GPIO_Init(EXT_RST_GPIO_Port, &GPIO_InitStruct);

  /*Configure GPIO pins : ULPI_CLK_Pin ULPI_D0_Pin */
  GPIO_InitStruct.Pin = ULPI_CLK_Pin|ULPI_D0_Pin;
  GPIO_InitStruct.Mode = GPIO_MODE_AF_PP;
  GPIO_InitStruct.Pull = GPIO_NOPULL;
  GPIO_InitStruct.Speed = GPIO_SPEED_FREQ_VERY_HIGH;
  GPIO_InitStruct.Alternate = GPIO_AF10_OTG_HS;
  HAL_GPIO_Init(GPIOA, &GPIO_InitStruct);

}

/* USER CODE BEGIN 4 */

/**
  * @brief  Function initializing the Piano interface
  * @param  argument: Not used
  * @retval None
  */
static void Piano_Init(void){
	// Draw param init
	BSP_LCD_Clear(LCD_COLOR_WHITE);
	BSP_LCD_SetFont(&Font12);
	BSP_LCD_SetTextColor(LCD_COLOR_BLACK);
	BSP_LCD_SetBackColor(LCD_COLOR_WHITE);

	// Drawing keys
	for (int i=0;i<8;i++){
		BSP_LCD_DrawRect(white[i], 0, white_w, white_h);
	}
	for (int i=0;i<5;i++){
		BSP_LCD_FillRect(black[i], 0, black_w+1, black_h);
	}
}

/**
  * @brief  Check for user input.
  * @param  None
  * @retval Input state (1 : active / 0 : Inactive)
  */
uint8_t CheckForUserInput(void)
{
  if (BSP_PB_GetState(BUTTON_KEY) != RESET)
  {
    HAL_Delay(10);
    while (BSP_PB_GetState(BUTTON_KEY) != RESET);
    return 1 ;
  }
  return 0;
}

/**
 * @brief  Display Audio demo hint
 * @param  None
 * @retval None
 */
static void Audio_SetHint(void)
{
	/* Clear the LCD */
	BSP_LCD_Clear(LCD_COLOR_WHITE);

	/* Set Audio Demo description */
	BSP_LCD_SetTextColor(LCD_COLOR_BLUE);
	BSP_LCD_FillRect(0, 0, BSP_LCD_GetXSize(), 90);
	BSP_LCD_SetTextColor(LCD_COLOR_WHITE);
	BSP_LCD_SetBackColor(LCD_COLOR_BLUE);
	BSP_LCD_SetFont(&Font24);
	BSP_LCD_DisplayStringAt(0, 0, (uint8_t *)"AUDIO EXAMPLE", CENTER_MODE);
	BSP_LCD_SetFont(&Font12);
	BSP_LCD_DisplayStringAt(0, 30, (uint8_t *)"Press User button for next menu", CENTER_MODE);
	BSP_LCD_DisplayStringAt(0, 45, (uint8_t *)"Press Top/Bottom screen to change Volume   ", CENTER_MODE);
	BSP_LCD_DisplayStringAt(0, 60, (uint8_t *)"Press Left/Right screen to change Frequency", CENTER_MODE);
	BSP_LCD_DisplayStringAt(0, 75, (uint8_t *)"Press 2 fingers for Pause/Resume           ", CENTER_MODE);
	/* Set the LCD Text Color */
	BSP_LCD_SetTextColor(LCD_COLOR_BLUE);
	BSP_LCD_DrawRect(10, 100, BSP_LCD_GetXSize() - 20, BSP_LCD_GetYSize() - 110);
	BSP_LCD_DrawRect(11, 101, BSP_LCD_GetXSize() - 22, BSP_LCD_GetYSize() - 112);

}

/**
  * @brief  Display Audio Record demo hint
  * @param  None
  * @retval None
  */
static void AudioLoopback_SetHint(void)
{
  /* Clear the LCD */
  BSP_LCD_Clear(LCD_COLOR_WHITE);

  /* Set Audio Demo description */
  BSP_LCD_SetTextColor(LCD_COLOR_BLUE);
  BSP_LCD_FillRect(0, 0, BSP_LCD_GetXSize(), 90);
  BSP_LCD_SetTextColor(LCD_COLOR_WHITE);
  BSP_LCD_SetBackColor(LCD_COLOR_BLUE);
  BSP_LCD_SetFont(&Font24);
  BSP_LCD_DisplayStringAt(0, 0, (uint8_t *)"AUDIO LOOPBACK EXAMPLE", CENTER_MODE);
  BSP_LCD_SetFont(&Font12);
  BSP_LCD_DisplayStringAt(0, 30, (uint8_t *)"Press User button for next menu", CENTER_MODE);

  /* Set the LCD Text Color */
  BSP_LCD_SetTextColor(LCD_COLOR_BLUE);
  BSP_LCD_DrawRect(10, 100, BSP_LCD_GetXSize() - 20, BSP_LCD_GetYSize() - 110);
  BSP_LCD_DrawRect(11, 101, BSP_LCD_GetXSize() - 22, BSP_LCD_GetYSize() - 112);

}

/**
  * @brief  Starts Audio streaming.
  * @param  None
  * @retval Audio error
  */
AUDIO_ErrorTypeDef AUDIO_Start(uint32_t audio_start_address, uint32_t audio_file_size)
{
	uint32_t bytesread;

	buffer_ctl.state = BUFFER_OFFSET_NONE;
	AudioStartAddress = audio_start_address;
	AudioFileSize = audio_file_size;
	bytesread = GetData( (void *)AudioStartAddress,
			0,
			&buffer_ctl.buff[0],
			AUDIO_BUFFER_SIZE);
	if(bytesread > 0)
	{
		/* Clean Data Cache to update the content of the SRAM */
		SCB_CleanDCache_by_Addr((uint32_t*)&buffer_ctl.buff[0], AUDIO_BUFFER_SIZE/2);

		BSP_AUDIO_OUT_Play((uint16_t*)&buffer_ctl.buff[0], AUDIO_BUFFER_SIZE);
		audio_state = AUDIO_STATE_PLAYING;
		buffer_ctl.fptr = bytesread;
		return AUDIO_ERROR_NONE;
	}
	return AUDIO_ERROR_IO;
}

/**
  * @brief  Manages Audio process.
  * @param  None
  * @retval Audio error
  */
uint8_t AUDIO_Process(void)
{
	uint32_t bytesread;
	AUDIO_ErrorTypeDef error_state = AUDIO_ERROR_NONE;

	switch(audio_state)
	{
	case AUDIO_STATE_PLAYING:

		if(buffer_ctl.fptr >= AudioFileSize)
		{
			/* Play audio sample again ... */
			buffer_ctl.fptr = 0;
			error_state = AUDIO_ERROR_EOF;
		}

		/* 1st half buffer played; so fill it and continue playing from bottom*/
		if(buffer_ctl.state == BUFFER_OFFSET_HALF)
		{
			bytesread = GetData((void *)AudioStartAddress,
					buffer_ctl.fptr,
					&buffer_ctl.buff[0],
					AUDIO_BUFFER_SIZE /2);

			if( bytesread >0)
			{
				buffer_ctl.state = BUFFER_OFFSET_NONE;
				buffer_ctl.fptr += bytesread;

				/* Clean Data Cache to update the content of the SRAM */
				SCB_CleanDCache_by_Addr((uint32_t*)&buffer_ctl.buff[0], AUDIO_BUFFER_SIZE/2);
			}
		}

		/* 2nd half buffer played; so fill it and continue playing from top */
		if(buffer_ctl.state == BUFFER_OFFSET_FULL)
		{
			bytesread = GetData((void *)AudioStartAddress,
					buffer_ctl.fptr,
					&buffer_ctl.buff[AUDIO_BUFFER_SIZE /2],
					AUDIO_BUFFER_SIZE /2);
			if( bytesread > 0)
			{
				buffer_ctl.state = BUFFER_OFFSET_NONE;
				buffer_ctl.fptr += bytesread;

				/* Clean Data Cache to update the content of the SRAM */
				SCB_CleanDCache_by_Addr((uint32_t*)&buffer_ctl.buff[AUDIO_BUFFER_SIZE/2], AUDIO_BUFFER_SIZE/2);
			}
		}
		break;

	default:
		error_state = AUDIO_ERROR_NOTREADY;
		break;
	}

	return (uint8_t) error_state;
}

/**
  * @brief  Gets Data from storage unit.
  * @param  None
  * @retval None
  */
static uint32_t GetData(void *pdata, uint32_t offset, uint8_t *pbuf, uint32_t NbrOfData)
{
	uint8_t *lptr = pdata;
	uint32_t ReadDataNbr;

	ReadDataNbr = 0;
	while(((offset + ReadDataNbr) < AudioFileSize) && (ReadDataNbr < NbrOfData))
	{
		pbuf[ReadDataNbr]= lptr [offset + ReadDataNbr];
		ReadDataNbr++;
	}
	return ReadDataNbr;
}

/*------------------------------------------------------------------------------
       Callbacks implementation:
           the callbacks API are defined __weak in the stm32746g_discovery_audio.c file
           and their implementation should be done the user code if they are needed.
           Below some examples of callback implementations.
  ----------------------------------------------------------------------------*/
/**
  * @brief  Manages the full Transfer complete event.
  * @param  None
  * @retval None
  */
void BSP_AUDIO_OUT_TransferComplete_CallBack(void)
{
	if(audio_state == AUDIO_STATE_PLAYING)
	{
		/* allows AUDIO_Process() to refill 2nd part of the buffer  */
		buffer_ctl.state = BUFFER_OFFSET_FULL;
	}
}

/**
  * @brief  Manages the DMA Half Transfer complete event.
  * @param  None
  * @retval None
  */
void BSP_AUDIO_OUT_HalfTransfer_CallBack(void)
{
	if(audio_state == AUDIO_STATE_PLAYING)
	{
		/* allows AUDIO_Process() to refill 1st part of the buffer  */
		buffer_ctl.state = BUFFER_OFFSET_HALF;
	}
}

/**
  * @brief  Manages the DMA FIFO error event.
  * @param  None
  * @retval None
  */
void BSP_AUDIO_OUT_Error_CallBack(void)
{
	/* Display message on the LCD screen */
	BSP_LCD_SetBackColor(LCD_COLOR_RED);
	BSP_LCD_DisplayStringAtLine(14, (uint8_t *)"       DMA  ERROR     ");

	/* Stop the program with an infinite loop */
	while (BSP_PB_GetState(BUTTON_KEY) != RESET)
	{
		return;
	}

  /* could also generate a system reset to recover from the error */
  /* .... */
}

// Interrupt callback function
//void HAL_GPIO_EXTI_Callback(uint16_t GPIO_Pin){
//	// Touch screen interrupt
//	if(GPIO_Pin == TS_INT_PIN){
//		HAL_GPIO_TogglePin(LED12_GPIO_Port, LED12_Pin);
//
//		//BSP_TS_ITClear();
//	}
//}

/* USER CODE END 4 */

void StartDefaultTask(void const * argument)
{
  for(;;)
  {
    osDelay(1);
  }
}

void Audio_demo(void const * argument)
{
  /* USER CODE BEGIN Audio_demo */
	AudioLoopback_SetHint();

	  /* Initialize Audio Recorder */
	  if (BSP_AUDIO_IN_OUT_Init(INPUT_DEVICE_DIGITAL_MICROPHONE_2, OUTPUT_DEVICE_HEADPHONE, DEFAULT_AUDIO_IN_FREQ, DEFAULT_AUDIO_IN_BIT_RESOLUTION, DEFAULT_AUDIO_IN_CHANNEL_NBR) == AUDIO_OK)
	  {
	    BSP_LCD_SetBackColor(LCD_COLOR_WHITE);
	    BSP_LCD_SetTextColor(LCD_COLOR_GREEN);
	    BSP_LCD_DisplayStringAt(0, BSP_LCD_GetYSize() - 95, (uint8_t *)"  AUDIO RECORD INIT OK  ", CENTER_MODE);
	  }
	  else
	  {
	    BSP_LCD_SetBackColor(LCD_COLOR_WHITE);
	    BSP_LCD_SetTextColor(LCD_COLOR_RED);
	    BSP_LCD_DisplayStringAt(0, BSP_LCD_GetYSize() - 95, (uint8_t *)"  AUDIO RECORD INIT FAIL", CENTER_MODE);
	    BSP_LCD_DisplayStringAt(0, BSP_LCD_GetYSize() - 80, (uint8_t *)" Try to reset board ", CENTER_MODE);
	  }

	  /* Display the state on the screen */
	  BSP_LCD_SetBackColor(LCD_COLOR_WHITE);
	  BSP_LCD_SetTextColor(LCD_COLOR_BLUE);
	  BSP_LCD_DisplayStringAt(0, BSP_LCD_GetYSize() - 80, (uint8_t *)"Microphones sound streamed to headphones", CENTER_MODE);

	  /* Initialize SDRAM buffers */
	  memset((uint16_t*)AUDIO_BUFFER_IN, 0, AUDIO_BLOCK_SIZE*2);
	  memset((uint16_t*)AUDIO_BUFFER_OUT, 0, AUDIO_BLOCK_SIZE*2);
	  audio_rec_buffer_state = BUFFER_OFFSET_NONE;

	  /* Start Recording */
	  BSP_AUDIO_IN_Record((uint16_t*)AUDIO_BUFFER_IN, AUDIO_BLOCK_SIZE);

	  /* Start Playback */
	  BSP_AUDIO_OUT_SetAudioFrameSlot(CODEC_AUDIOFRAME_SLOT_02);
	  BSP_AUDIO_OUT_Play((uint16_t*)AUDIO_BUFFER_OUT, AUDIO_BLOCK_SIZE * 2);
  /* Infinite loop */
  for(;;)
  {
	  /* Wait end of half block recording */
	      while(audio_rec_buffer_state != BUFFER_OFFSET_HALF)
	      {
	        if (CheckForUserInput() > 0)
	        {
	          /* Stop Player before close Test */
	          BSP_AUDIO_OUT_Stop(CODEC_PDWN_SW);
	          /* Stop Player before close Test */
	          BSP_AUDIO_OUT_Stop(CODEC_PDWN_SW);
	          return;
	        }
	      }
	      audio_rec_buffer_state = BUFFER_OFFSET_NONE;
	      /* Copy recorded 1st half block */
	      memcpy((uint16_t *)(AUDIO_BUFFER_OUT),
	             (uint16_t *)(AUDIO_BUFFER_IN),
	             AUDIO_BLOCK_SIZE);

	      /* Wait end of one block recording */
	      while(audio_rec_buffer_state != BUFFER_OFFSET_FULL)
	      {
	        if (CheckForUserInput() > 0)
	        {
	          /* Stop Player before close Test */
	          BSP_AUDIO_OUT_Stop(CODEC_PDWN_SW);
	          /* Stop Player before close Test */
	          BSP_AUDIO_OUT_Stop(CODEC_PDWN_SW);
	          return;
	        }
	      }
	      audio_rec_buffer_state = BUFFER_OFFSET_NONE;
	      /* Copy recorded 2nd half block */
	      memcpy((uint16_t *)(AUDIO_BUFFER_OUT + (AUDIO_BLOCK_SIZE)),
	             (uint16_t *)(AUDIO_BUFFER_IN + (AUDIO_BLOCK_SIZE)),
	             AUDIO_BLOCK_SIZE);

	      if (CheckForUserInput() > 0)
	      {
	        /* Stop recorder */
	        BSP_AUDIO_IN_Stop(CODEC_PDWN_SW);
	        /* Stop Player before close Test */
	        BSP_AUDIO_OUT_Stop(CODEC_PDWN_SW);
	        return;
	      }
  }
  /* USER CODE END Audio_demo */
}

void TS_scan_task(void const * argument)
{
  /* USER CODE BEGIN TS_scan_task */
	static TS_StateTypeDef  prev_state;
	TS_StateTypeDef TS_State;
	const TickType_t period = 50;
	TickType_t xLastWakeTime;
	uint8_t w_pressed, b_pressed;
	uint8_t w_old, b_old;

	// Initialise the xLastWakeTime variable with the current time.
	xLastWakeTime = xTaskGetTickCount();

	/* Infinite loop */
	for(;;)
	{
		 BSP_TS_GetState(&TS_State);
		 if(TS_State.touchDetected != prev_state.touchDetected){
			 prev_state.touchDetected = TS_State.touchDetected;
			 nb_appuis = TS_State.touchDetected;
			 w_pressed = 0;
			 b_pressed = 0;
			 for (uint8_t i=0; i<TS_State.touchDetected; i++){
				 if(TS_State.touchY[i] < black_h){
					 for(uint8_t b=0; b<N_black; b++){
						 if(TS_State.touchX[i] > black[b] && TS_State.touchX[i] < black[b]+black_w){
							 b_pressed |= 1<<b;
						 }
					 }
					 for(uint8_t w=0; w<N_white; w++){
						 if(TS_State.touchX[i] > white_up[w] && TS_State.touchX[i] < white_up[w]+white_up_w[w]){
							 w_pressed |= 1<<w;
						 }
					 }
				 } else {
					 for(uint8_t w=0; w<N_white; w++){
						 if(TS_State.touchX[i] > white[w] && TS_State.touchX[i] < white[w]+white_w){
							 w_pressed |= 1<<w;
						 }
					 }
				 }
			 }
			 for(uint8_t b=0; b<N_black; b++){
				 if((b_pressed & (1<<b)) == (1<<b) && (b_old & (1<<b)) == 0){
					 BSP_LCD_SetTextColor(LCD_COLOR_BLUE);
					 BSP_LCD_FillRect(black[b]+1, 1, black_w-1, black_h-1);
				 } else if((b_pressed & (1<<b)) == 0 && (b_old & (1<<b)) == (1<<b)){
					 BSP_LCD_SetTextColor(LCD_COLOR_BLACK);
					 BSP_LCD_FillRect(black[b]+1, 1, black_w-1, black_h-1);
				 }
			 }
			 for(uint8_t w=0; w<N_white; w++){
				 if((w_pressed & (1<<w)) == (1<<w) && (w_old & (1<<w)) == 0){
					 BSP_LCD_SetTextColor(LCD_COLOR_BLUE);
					 BSP_LCD_FillRect(white_up[w]+1, 1, white_up_w[w]-1, black_h-1);
					 BSP_LCD_FillRect(white[w]+1, black_h, white_w-1, white_h);
				 } else if((w_pressed & (1<<w)) == 0 && (w_old & (1<<w)) == (1<<w)){
					 BSP_LCD_SetTextColor(LCD_COLOR_WHITE);
					 BSP_LCD_FillRect(white_up[w]+1, 1, white_up_w[w]-1, black_h-1);
					 BSP_LCD_FillRect(white[w]+1, black_h, white_w-1, white_h);
				 }
			 }
			 b_old = b_pressed;
			 w_old = w_pressed;
		 }
		 vTaskDelayUntil(&xLastWakeTime, period);
	}
  /* USER CODE END TS_scan_task */
}

 /**
  * @brief  Period elapsed callback in non blocking mode
  * @note   This function is called  when TIM6 interrupt took place, inside
  * HAL_TIM_IRQHandler(). It makes a direct call to HAL_IncTick() to increment
  * a global variable "uwTick" used as application time base.
  * @param  htim : TIM handle
  * @retval None
  */
void HAL_TIM_PeriodElapsedCallback(TIM_HandleTypeDef *htim)
{
  if (htim->Instance == TIM6) {
    HAL_IncTick();
  }
}

void Error_Handler(void)
{
  __disable_irq();
  while (1)
  {
  }
}

/************************ (C) COPYRIGHT STMicroelectronics *****END OF FILE****/
